/*
  ND DMX NODE 4U v2.2 - W5500-EVB-Pico2 / RP2350
  W5500-EVB-Pico2 / RP2350 + integrated W5500 + four MAX485 DMX TX
  outputs and ESP32-C5 UART

  Recommended Arduino-Pico settings:
    Board:       W5500-EVB-Pico2 / RP2350 (or the matching RP2350 board entry)
    CPU Speed:   Board/core default
    Flash Size:  Board default (integrated 16 Mbit flash)
    USB Stack:   Pico SDK
    Optimize:    Small (-Os)
*/

#include <Arduino.h>
#include <SPI.h>
#include <EthernetCompat.h>
#include "ND_SPI_Protocol.h"

// Temporary network bring-up guard. Normal production keeps Art-Net discovery
// replies enabled; diagnostic builds may override this explicitly if needed.
#ifndef EMERGENCY_NETWORK_SAFE_MODE
#define EMERGENCY_NETWORK_SAFE_MODE 0
#endif

// Ethernet bring-up bisect.  1=A Ethernet, 2=B +HTTP, 3=C +Art-Net,
// 4=D +sACN, 5=E +ESP UART, 6=F +Core1/DMX, 7=G full production.
// The default is full production; temporary builds can select a stage with
// -DND_ETH_BISECT_STAGE=<1..7> without changing network literals or pins.
#ifndef ND_ETH_BISECT_STAGE
#define ND_ETH_BISECT_STAGE 7
#endif

#ifndef ND_INTERPROCESS_SPI
#define ND_INTERPROCESS_SPI 1
#endif
#ifndef ND_SPI_FORENSIC_DIAGNOSTICS
#define ND_SPI_FORENSIC_DIAGNOSTICS 0
#endif
#ifndef ND_INTERPROCESS_UART
#define ND_INTERPROCESS_UART 0
#endif

#if ND_ETH_BISECT_STAGE == 1

// Exact runtime-equivalence branch copied from the hardware-validated
// /private/tmp/W5500_ONLY_TEST/W5500_ONLY_TEST.ino.  Keep this branch free of
// production globals, watchdog, EEPROM, PIO, multicore, sockets and services.
#define W5500_MISO_PIN 16
#define W5500_CS_PIN   17
#define W5500_SCK_PIN  18
#define W5500_MOSI_PIN 19
#define W5500_RST_PIN  20
#define W5500_INT_PIN  21
#define HARDWARE_LED_PIN 25

ArduinoWiznet5500lwIP Ethernet(W5500_CS_PIN, SPI, W5500_INT_PIN);
byte mac[] = { 0x02, 0x4E, 0x44, 0x34, 0x55, 0x01 };

static uint32_t lastLinkPollMs = 0;
static uint32_t lastLedToggleMs = 0;
static bool ledState = false;

static void serviceLinkLed() {
  const uint32_t now = millis();
  if (now - lastLinkPollMs < 1000u) return;
  lastLinkPollMs = now;

  const bool linkUp = Ethernet.linkStatus() == LinkON;
  if (linkUp) {
    ledState = true;
    digitalWrite(HARDWARE_LED_PIN, HIGH);
  } else if (now - lastLedToggleMs >= 1000u) {
    ledState = !ledState;
    digitalWrite(HARDWARE_LED_PIN, ledState ? HIGH : LOW);
    lastLedToggleMs = now;
  }
  Serial.print(F("[W5500 TEST] link="));
  Serial.println(linkUp ? F("UP") : F("DOWN"));
}

void setup() {
  Serial.begin(115200);
  delay(1000);
  pinMode(HARDWARE_LED_PIN, OUTPUT);
  digitalWrite(HARDWARE_LED_PIN, LOW);

  Serial.println(F("W5500_ONLY_TEST RP2350 / W5500-EVB-Pico2"));
  Serial.println(F("[TEST] Integrated W5500 initialization begins"));

  pinMode(W5500_RST_PIN, OUTPUT);
  digitalWrite(W5500_RST_PIN, LOW);
  delay(100);
  digitalWrite(W5500_RST_PIN, HIGH);
  delay(500);

  SPI.setRX(W5500_MISO_PIN);
  SPI.setCS(W5500_CS_PIN);
  SPI.setSCK(W5500_SCK_PIN);
  SPI.setTX(W5500_MOSI_PIN);
  SPI.begin();

  IPAddress staticIP(10, 10, 10, 10);
  IPAddress dnsServer(10, 10, 10, 1);
  IPAddress gateway(10, 10, 10, 1);
  IPAddress subnetMask(255, 255, 255, 0);
  const bool ethernetStarted = Ethernet.begin(mac, staticIP, dnsServer, gateway, subnetMask);

  const bool hardwareOk = Ethernet.hardwareStatus() != EthernetNoHardware;
  const bool ipOk = Ethernet.localIP() == staticIP;
  const bool linkUp = Ethernet.linkStatus() == LinkON;
  Serial.print(F("[TEST] W5500 init: "));
  Serial.println(ethernetStarted && hardwareOk ? F("PASS") : F("FAIL"));
  Serial.print(F("[TEST] IP: ")); Serial.println(ipOk ? F("PASS 10.10.10.10") : F("FAIL"));
  Serial.print(F("[TEST] Link: ")); Serial.println(linkUp ? F("UP") : F("DOWN"));
  Serial.println(F("[TEST] Ethernet initialized once; no loop reinitialization"));

  ledState = linkUp;
  digitalWrite(HARDWARE_LED_PIN, linkUp ? HIGH : LOW);
  lastLedToggleMs = millis();
}

void loop() {
  serviceLinkLed();
}

#else

#include <EEPROM.h>
#include <Updater.h>
extern uint8_t _FS_start;
extern uint8_t _FS_end;
#include "hardware/pio.h"
#include "hardware/gpio.h"
#include "hardware/clocks.h"
#include "hardware/watchdog.h"
#include "pico/time.h"     // Pico SDK system uptime
#include "hardware/sync.h" // Pico SDK spinlock API (RP2350-compatible)

// Arduino's automatic prototype generator can place calcCRC() before the
// full Config definition. Forward-declare the type for the .ino build.
struct Config;

static const uint32_t RESET_DIAG_MAGIC = 0x4E444D00u;
static uint32_t previousResetCode = 0;
static uint8_t previousBootStage = 0;
static bool previousBootCompleted = true;
enum RuntimeStage : uint8_t { RT_LOOP_START, RT_NETWORK_RX, RT_ARTNET, RT_SACN, RT_WEB, RT_DMX, RT_LOOP_COMPLETE };
static volatile RuntimeStage runtimeStage = RT_LOOP_START;
enum BootStage : uint8_t { BOOT_START = 0, CONFIG_LOAD, DMX_INIT, W5500_RESET, SPI_INIT, ETHERNET_INIT, ETHERNET_READY, SACN_INIT, WEB_SERVER_INIT, ARTNET_INIT, CORE_SYNC, BOOT_COMPLETE };
static BootStage currentBootStage = BOOT_START;
extern volatile uint32_t core1_heartbeat;
extern volatile uint32_t lCount1;

static const char* resetReason(uint32_t code) {
  switch (code) {
    case 1: return "Core 1 heartbeat stalled";
    case 2: return "Watchdog expired";
    case 3: return "PIO recovery failure";
    default: return code ? "Unknown reset" : "Power-on/software reset";
  }
}
static const char* bootStageName(uint8_t stage) {
  switch (stage) {
    case BOOT_START: return "BOOT_START"; case CONFIG_LOAD: return "CONFIG_LOAD";
    case DMX_INIT: return "DMX_INIT"; case W5500_RESET: return "W5500_RESET"; case SPI_INIT: return "SPI_INIT";
    case ETHERNET_INIT: return "ETHERNET_INIT"; case ETHERNET_READY: return "ETHERNET_READY"; case SACN_INIT: return "SACN_INIT";
    case WEB_SERVER_INIT: return "WEB_SERVER_INIT"; case ARTNET_INIT: return "ARTNET_INIT"; case CORE_SYNC: return "CORE_SYNC";
    case BOOT_COMPLETE: return "BOOT_COMPLETE"; default: return "UNKNOWN_STAGE";
  }
}
// scratch[0]=magic; scratch[1]=reset code(0..7), stage(8..15), complete(16), attempts(24..31)
// scratch[2]=Core 1 heartbeat; scratch[3]=Core 1 loop counter; scratch[4]=runtime stage.
static void recordBootStage(BootStage stage) {
  currentBootStage = stage;
  const uint32_t attempts = ((watchdog_hw->scratch[1] >> 24) + 1u) & 0xFFu;
  watchdog_hw->scratch[0] = RESET_DIAG_MAGIC;
  watchdog_hw->scratch[1] = (static_cast<uint32_t>(previousResetCode) & 0xFFu) | (static_cast<uint32_t>(stage) << 8) | (attempts << 24);
  Serial.print(F("[BOOT ")); Serial.print(static_cast<int>(stage)); Serial.print(F("] ")); Serial.println(bootStageName(stage));
  watchdog_update();
}
static void markBootComplete() {
  currentBootStage = BOOT_COMPLETE;
  watchdog_hw->scratch[1] = (watchdog_hw->scratch[1] & 0xFF00FFFFu) | (static_cast<uint32_t>(BOOT_COMPLETE) << 8) | (1u << 16);
  Serial.println(F("[BOOT OK] COMPLETE"));
}

static void saveResetDiagnostic(uint32_t code) {
  watchdog_hw->scratch[0] = RESET_DIAG_MAGIC;
  watchdog_hw->scratch[1] = (code & 0xFFu) | (static_cast<uint32_t>(currentBootStage) << 8) |
                            (currentBootStage == BOOT_COMPLETE ? (1u << 16) : 0u);
  watchdog_hw->scratch[2] = __atomic_load_n(&core1_heartbeat, __ATOMIC_RELAXED);
  watchdog_hw->scratch[3] = __atomic_load_n(&lCount1, __ATOMIC_RELAXED);
  watchdog_hw->scratch[4] = static_cast<uint32_t>(runtimeStage);
}

static const char* runtimeStageName(uint8_t stage) {
  switch (stage) { case RT_LOOP_START: return "LOOP_START"; case RT_NETWORK_RX: return "NETWORK_RX"; case RT_ARTNET: return "ARTNET"; case RT_SACN: return "SACN"; case RT_WEB: return "WEB"; case RT_DMX: return "DMX"; case RT_LOOP_COMPLETE: return "LOOP_COMPLETE"; default: return "UNKNOWN"; }
}
static inline void setRuntimeStage(RuntimeStage stage) { runtimeStage = stage; watchdog_hw->scratch[4] = static_cast<uint32_t>(stage); }

#define HARDWARE_LED_PIN 25

class DashboardWriter : public Print {
public:
  virtual bool connected() const = 0;
  virtual void service() {}
};

// ================= ESP32-C5 inter-processor transport =================
#if ND_INTERPROCESS_UART
// Bounded line-framed transport. The RP2350 remains the sole dashboard/API,
// universe-routing, and DMX authority; the ESP32 supplies Wi-Fi ingress and
// forwards bounded HTTP/lighting records.
#define ESP_UART_TX_PIN 4
#define ESP_UART_RX_PIN 5
#define ESP_UART_BAUD 115200
#define ESP_UART_LINE_MAX 768
#define ESP_UART_REQUEST_MAX 512
#define ESP_UART_RESPONSE_MAX 16384
#define ESP_UART_CHUNK 192
static bool espUartReady = false;
static uint32_t lastEspUartHeartbeatMs = 0;
static uint32_t espUartLastSeenMs = 0;
static bool espUartLinkAlive = false;
static char espUartRxLine[ESP_UART_LINE_MAX];
static size_t espUartRxLength = 0;
static bool espUartRxOverflowActive = false;
static char espWifiStatus[256] = "state=UNKNOWN;mode=UNKNOWN;ssid=;ip=;rssi=0;clients=0";
static char espLastFrameType[12] = "NONE";
static char espLastTelemetryResult[24] = "NONE";
static uint32_t espValidFrameCount = 0;
static uint32_t espTelemetryFrameCount = 0;
static uint32_t espTelemetryDecodeSuccessCount = 0;
static uint32_t espTelemetryDecodeFailureCount = 0;
static uint32_t espTelemetryValidationFailureCount = 0;
static uint32_t espUartRxOverflowCount = 0;
static uint32_t espUartRxBytes = 0;
static uint32_t espUartRxLines = 0;
static uint32_t espUartValidFrames = 0;
static uint32_t espUartInvalidFrames = 0;
static uint32_t espUartReqFrames = 0;
static uint32_t espUartReadyFrames = 0;
static uint32_t espUartHbFrames = 0;
static uint32_t espUartWifiFrames = 0;
static uint32_t espUartUnknownFrames = 0;
static uint32_t espUartTxBytes = 0;
static uint32_t espUartTxFrames = 0;
static uint32_t espUartRespFrames = 0;
static uint32_t espUartDataFrames = 0;
static uint32_t espUartEndFrames = 0;
static uint32_t espHttpReqReceived = 0;
static uint32_t espHttpResponsesStarted = 0;
static uint32_t espHttpDataChunksSent = 0;
static uint32_t espHttpResponsesCompleted = 0;
static uint16_t lastReqId = 0;
static char lastReqPath[96] = "";
static uint16_t lastResponseId = 0;
static char lastResponseStatus[24] = "";
static uint32_t lastResponseBytes = 0;
static uint16_t lastInvalidFrameLength = 0;
static char lastInvalidFrameReason[24] = "";
static char lastInvalidFrame[121] = "";
static uint16_t espLastTelemetryLength = 0;
static uint16_t espUartNextId = 1;
static bool espWifiConfigPending = false;
static bool espWifiConfigAcked = false;
static uint16_t espWifiConfigPendingId = 0;
static char espWifiConfigAckMessage[32] = "";
static uint32_t espWifiArtRxCount = 0;
static uint32_t espWifiArtDropCount = 0;
static uint32_t espWifiSacnRxCount = 0;
static uint32_t espWifiSacnDropCount = 0;
static constexpr uint32_t ESP_UART_TX_QUEUE_SIZE = 32768;
// Arduino-Pico 6.1.0 reports SerialUART::availableForWrite() as 0/1 and
// write() can wait for the UART to accept each byte. Bound each service pass
// so a proxied Wi-Fi response cannot starve native W5500 packet servicing.
static constexpr uint16_t ESP_UART_TX_SERVICE_BUDGET = 64;
static uint8_t espUartTxQueue[ESP_UART_TX_QUEUE_SIZE];
static uint32_t espUartTxHead = 0;
static uint32_t espUartTxTail = 0;
static bool espUartTxOverflowReported = false;
class UartDashboardWriter;

static const char UART_B64[] = "ABCDEFGHIJKLMNOPQRSTUVWXYZabcdefghijklmnopqrstuvwxyz0123456789+/";
static size_t b64Encode(const uint8_t* in, size_t len, char* out, size_t cap) {
  size_t oi = 0;
  for (size_t i = 0; i < len; i += 3) {
    if (oi + 4 >= cap) return 0;
    const uint32_t v = (static_cast<uint32_t>(in[i]) << 16) |
      ((i + 1 < len ? in[i + 1] : 0) << 8) | (i + 2 < len ? in[i + 2] : 0);
    out[oi++] = UART_B64[(v >> 18) & 63]; out[oi++] = UART_B64[(v >> 12) & 63];
    out[oi++] = i + 1 < len ? UART_B64[(v >> 6) & 63] : '=';
    out[oi++] = i + 2 < len ? UART_B64[v & 63] : '=';
  }
  out[oi] = '\0'; return oi;
}
static int b64Value(char c) { if (c >= 'A' && c <= 'Z') return c - 'A'; if (c >= 'a' && c <= 'z') return c - 'a' + 26; if (c >= '0' && c <= '9') return c - '0' + 52; if (c == '+') return 62; if (c == '/') return 63; return -1; }
static size_t b64Decode(const char* in, uint8_t* out, size_t cap) {
  size_t oi = 0; int val = 0; int bits = -8;
  for (const char* p = in; *p; ++p) { if (*p == '=') break; const int n = b64Value(*p); if (n < 0) return 0; val = (val << 6) | n; bits += 6; if (bits >= 0) { if (oi >= cap) return 0; out[oi++] = (val >> bits) & 255; bits -= 8; } }
  return oi;
}
static void serviceEspUartTx() {
  uint16_t sent = 0;
  while (sent < ESP_UART_TX_SERVICE_BUDGET &&
         espUartTxTail != espUartTxHead && Serial2.availableForWrite() > 0) {
    if (Serial2.write(espUartTxQueue[espUartTxTail]) == 1) ++espUartTxBytes;
    espUartTxTail = (espUartTxTail + 1u) % ESP_UART_TX_QUEUE_SIZE;
    ++sent;
  }
}
static void recordInvalidEspFrame(const char* line, const char* reason) {
  ++espUartInvalidFrames;
  lastInvalidFrameLength = static_cast<uint16_t>(strlen(line));
  strncpy(lastInvalidFrameReason, reason ? reason : "OTHER", sizeof(lastInvalidFrameReason) - 1);
  lastInvalidFrameReason[sizeof(lastInvalidFrameReason) - 1] = '\0';
  size_t n = strlen(line); if (n > sizeof(lastInvalidFrame) - 1) n = sizeof(lastInvalidFrame) - 1;
  for (size_t i = 0; i < n; ++i) {
    const unsigned char c = static_cast<unsigned char>(line[i]);
    lastInvalidFrame[i] = (c >= 32 && c <= 126) ? static_cast<char>(c) : '?';
  }
  lastInvalidFrame[n] = '\0';
}
static void copyReqPath(const uint8_t* request, size_t length) {
  lastReqPath[0] = '\0';
  const char* begin = reinterpret_cast<const char*>(request);
  const char* first = strchr(begin, ' '); if (!first) return; ++first;
  const char* end = strchr(first, ' '); if (!end) end = begin + length;
  size_t n = static_cast<size_t>(end - first); if (n >= sizeof(lastReqPath)) n = sizeof(lastReqPath) - 1;
  memcpy(lastReqPath, first, n); lastReqPath[n] = '\0';
}
static void copyHttpStatus(const uint8_t* response, size_t length) {
  lastResponseStatus[0] = '\0';
  size_t space = 0; while (space < length && response[space] != ' ') ++space;
  if (space >= length) return; ++space;
  size_t end = space; while (end < length && response[end] != ' ' && response[end] != '\r' && response[end] != '\n') ++end;
  size_t n = end - space; if (n >= sizeof(lastResponseStatus)) n = sizeof(lastResponseStatus) - 1;
  memcpy(lastResponseStatus, response + space, n); lastResponseStatus[n] = '\0';
}
static void sendEspFrame(const char* type, uint16_t id = 0, const char* payload = nullptr) {
  if (!espUartReady) return;
  char frame[360];
  const int count = snprintf(frame, sizeof(frame), payload ? "ND1|%s|%u|%s\n" : "ND1|%s|%u\n", type, id, payload ? payload : "");
  if (count <= 0 || static_cast<size_t>(count) >= sizeof(frame)) return;
  const uint32_t used = (espUartTxHead + ESP_UART_TX_QUEUE_SIZE - espUartTxTail) % ESP_UART_TX_QUEUE_SIZE;
  if (static_cast<uint32_t>(count) >= ESP_UART_TX_QUEUE_SIZE - used) {
    if (!espUartTxOverflowReported) { Serial.println(F("[WARN] ESP UART TX queue full; frame dropped")); espUartTxOverflowReported = true; }
    return;
  }
  ++espUartTxFrames;
  if (!strcmp(type, "RESP")) ++espUartRespFrames;
  else if (!strcmp(type, "DATA")) ++espUartDataFrames;
  else if (!strcmp(type, "END")) ++espUartEndFrames;
  for (int i = 0; i < count; ++i) {
    espUartTxQueue[espUartTxHead] = static_cast<uint8_t>(frame[i]);
    espUartTxHead = (espUartTxHead + 1u) % ESP_UART_TX_QUEUE_SIZE;
  }
}
static bool uartField(const char* line, uint8_t field, char* out, size_t cap) {
  const char* p = line; for (uint8_t i = 0; i < field; ++i) { p = strchr(p, '|'); if (!p) return false; ++p; }
  const char* e = strchr(p, '|'); if (!e) e = p + strlen(p); const size_t n = static_cast<size_t>(e - p);
  if (n >= cap) return false; memcpy(out, p, n); out[n] = '\0'; return true;
}
static void sendEspHttpResponse(uint16_t id, UartDashboardWriter& response);
static void handleEspFrame(const char* line);

void initEspUart() {
  Serial2.setTX(ESP_UART_TX_PIN);
  Serial2.setRX(ESP_UART_RX_PIN);
  Serial2.begin(ESP_UART_BAUD);
  espUartReady = true;
  sendEspFrame("HELLO", 0, "1");
  Serial.print(F("[DIAG] ESP32 UART: PASS (TX GP")); Serial.print(ESP_UART_TX_PIN);
  Serial.print(F(" / RX GP")); Serial.print(ESP_UART_RX_PIN);
  Serial.print(F(" / ")); Serial.print(ESP_UART_BAUD); Serial.println(F(" baud)"));
}

void serviceEspUart() {
  if (!espUartReady) return;
  serviceEspUartTx();
  while (Serial2.available() > 0) {
    const char c = static_cast<char>(Serial2.read());
    ++espUartRxBytes;
    if (c == '\n' || c == '\r') {
      if (espUartRxOverflowActive) {
        ++espUartRxLines;
        espUartRxLine[sizeof(espUartRxLine) - 1] = '\0';
        recordInvalidEspFrame(espUartRxLine, "OVERFLOW");
        espUartRxLength = 0;
        espUartRxOverflowActive = false;
      } else if (espUartRxLength > 0) {
        ++espUartRxLines;
        espUartRxLine[espUartRxLength] = '\0';
        handleEspFrame(espUartRxLine);
        espUartRxLength = 0;
      }
    } else if (espUartRxLength < sizeof(espUartRxLine) - 1) {
      espUartRxLine[espUartRxLength++] = c;
    } else {
      ++espUartRxOverflowCount;
      espUartRxOverflowActive = true;
      if (espUartRxLength < sizeof(espUartRxLine) - 1) ++espUartRxLength;
    }
  }
  const uint32_t now = millis();
  if (now - lastEspUartHeartbeatMs >= 5000u) {
    sendEspFrame("HB");
    lastEspUartHeartbeatMs = now;
  }
  serviceEspUartTx();
}

#else

// V3.4A production SPI adapter.  UART symbols are retained as compatibility
// names for the existing status/dashboard code, but no UART peripheral is
// initialized or serviced when ND_INTERPROCESS_SPI is enabled.
static constexpr uint8_t ESP_SPI_MISO = 12, ESP_SPI_CS = 13, ESP_SPI_SCK = 14, ESP_SPI_MOSI = 15, ESP_SPI_READY = 11;
static constexpr uint16_t ESP_SPI_QUEUE_DEPTH = 32;
#define ESP_UART_RESPONSE_MAX 16384
static constexpr uint32_t ESP_SPI_POLL_MS = 10;
static bool espUartReady = false, espUartLinkAlive = false;
static uint32_t espUartLastSeenMs = 0, lastEspUartHeartbeatMs = 0;
static char espWifiStatus[256] = "state=UNKNOWN;mode=UNKNOWN;ssid=;ip=;rssi=0;clients=0";
static char espLastFrameType[16] = "NONE", espLastTelemetryResult[24] = "SPI";
static uint32_t espValidFrameCount = 0, espTelemetryFrameCount = 0, espTelemetryDecodeSuccessCount = 0, espTelemetryDecodeFailureCount = 0, espTelemetryValidationFailureCount = 0, espUartRxBytes = 0, espUartRxLines = 0, espUartValidFrames = 0, espUartInvalidFrames = 0, espUartReqFrames = 0, espUartReadyFrames = 0, espUartHbFrames = 0, espUartWifiFrames = 0, espUartUnknownFrames = 0, espUartTxBytes = 0, espUartTxFrames = 0, espUartRespFrames = 0, espUartDataFrames = 0, espUartEndFrames = 0, espHttpReqReceived = 0, espHttpResponsesStarted = 0, espHttpDataChunksSent = 0, espHttpResponsesCompleted = 0;
static uint32_t espUartRxOverflowCount = 0, espLastTelemetryLength = 0; static uint16_t lastInvalidFrameLength = 0; static char lastInvalidFrameReason[24] = ""; static char lastInvalidFrame[121] = "";
static uint32_t spiTransactions = 0, spiValidFrames = 0, spiCrcErrors = 0, spiMagicErrors = 0, spiVersionErrors = 0, spiLengthErrors = 0, spiSequenceErrors = 0, spiRxDrops = 0, spiTxDrops = 0, spiLightingDrops = 0, spiLinkResyncs = 0, spiReadyHighCount = 0, spiReadyMismatchCount = 0;
#if ND_SPI_FORENSIC_DIAGNOSTICS
static bool spiFirstInvalidCaptured = false;
static uint8_t spiFirstInvalidTx[16] = {}, spiFirstInvalidRx[32] = {};
static uint32_t spiFirstInvalidTxSeq = 0;
static uint16_t spiFirstInvalidMagic = 0, spiFirstInvalidLength = 0;
static uint8_t spiFirstInvalidVersion = 0, spiFirstInvalidType = 0, spiFirstInvalidReady = 0;
static char spiFirstInvalidReason[8] = "";
#endif
static uint16_t lastReqId = 0, lastResponseId = 0; static char lastReqPath[96] = "", lastResponseStatus[24] = ""; static uint32_t lastResponseBytes = 0;
static uint32_t espWifiArtRxCount = 0, espWifiArtDropCount = 0, espWifiSacnRxCount = 0, espWifiSacnDropCount = 0;
static uint8_t spiTxFrame[ND_SPI::FRAME_BYTES], spiRxFrame[ND_SPI::FRAME_BYTES];
static uint8_t spiQueue[ESP_SPI_QUEUE_DEPTH][ND_SPI::FRAME_BYTES]; static uint8_t spiQueueHead = 0, spiQueueTail = 0;
static uint32_t spiSequence = 1, spiLastPollMs = 0, spiLastStatusMs = 0; static bool spiSynced = false; static uint32_t spiPendingRequestId = 1;
static uint16_t espUartNextId = 1;
static bool espWifiConfigPending = false, espWifiConfigAcked = false; static uint16_t espWifiConfigPendingId = 0; static char espWifiConfigAckMessage[32] = "";
#define ESP_UART_REQUEST_MAX 512
static uint32_t spiCrc32(const uint8_t *p, size_t n) { return ND_SPI::crc32(p, n); }
static bool spiQueueFrame(uint8_t type, uint32_t sequence, uint16_t flags, uint32_t channel, const uint8_t *payload, uint16_t length, bool lighting = false) {
  const uint8_t next = uint8_t((spiQueueHead + 1u) % ESP_SPI_QUEUE_DEPTH);
  if (next == spiQueueTail) { if (lighting) ++spiLightingDrops; else ++spiTxDrops; return false; }
  ND_SPI::build(spiQueue[spiQueueHead], type, sequence, flags, channel, payload, length); spiQueueHead = next; ++espUartTxFrames; return true;
}
static bool spiPop(uint8_t *out) { if (spiQueueTail == spiQueueHead) return false; memcpy(out, spiQueue[spiQueueTail], ND_SPI::FRAME_BYTES); spiQueueTail = uint8_t((spiQueueTail + 1u) % ESP_SPI_QUEUE_DEPTH); return true; }
static void queueSpiHello() { uint8_t p[4] = { 'R', 'P', '3', '5' }; spiQueueFrame(ND_SPI::SPI_MSG_HELLO, spiSequence, ND_SPI::FLAG_FIRST | ND_SPI::FLAG_LAST, 0, p, sizeof(p)); }
static void queueSpiStatusSubscription(const char *subscriptions = "1,2,3,4") { char s[64]; snprintf(s, sizeof(s), "SUB|%s", subscriptions ? subscriptions : "1,2,3,4"); spiQueueFrame(ND_SPI::SPI_MSG_STATUS_RESPONSE, spiSequence, ND_SPI::FLAG_FIRST | ND_SPI::FLAG_LAST, 0, reinterpret_cast<const uint8_t*>(s), uint16_t(strlen(s))); }
static void sendEspFrame(const char *type, uint16_t id = 0, const char *payload = nullptr) {
  if (!strcmp(type, "HELLO")) queueSpiHello();
  else if (!strcmp(type, "SUB")) queueSpiStatusSubscription(payload);
  else if (!strcmp(type, "HB")) { const char *s = "HB"; spiQueueFrame(ND_SPI::SPI_MSG_STATUS_RESPONSE, spiSequence, ND_SPI::FLAG_FIRST | ND_SPI::FLAG_LAST, 0, reinterpret_cast<const uint8_t*>(s), 2); }
  else if (!strcmp(type, "WIFI_SET") && payload) spiQueueFrame(ND_SPI::SPI_MSG_STATUS_REQUEST, spiSequence, ND_SPI::FLAG_FIRST | ND_SPI::FLAG_LAST, id, reinterpret_cast<const uint8_t*>(payload), uint16_t(strlen(payload)));
}
static void processSpiFrame(const uint8_t *frame);
#if ND_SPI_FORENSIC_DIAGNOSTICS
static const char *spiValidationReason(const uint8_t *frame) {
  if (ND_SPI::get16(frame) != ND_SPI::MAGIC) return "MAGIC";
  if (frame[2] != ND_SPI::VERSION) return "VERSION";
  if (frame[3] > ND_SPI::SPI_MSG_ERROR) return "TYPE";
  if (!ND_SPI::validLength(ND_SPI::get16(frame + 8))) return "LENGTH";
  if (ND_SPI::get32(frame + ND_SPI::HEADER_BYTES + ND_SPI::get16(frame + 8)) != ND_SPI::crc32(frame, ND_SPI::HEADER_BYTES + ND_SPI::get16(frame + 8))) return "CRC";
  return nullptr;
}
#endif
#if ND_SPI_FORENSIC_DIAGNOSTICS
static void captureFirstInvalidSpiFrame(const uint8_t *tx, const uint8_t *rx) {
  if (spiFirstInvalidCaptured) return;
  const char *reason = spiValidationReason(rx);
  if (!reason) return;
  spiFirstInvalidCaptured = true;
  memcpy(spiFirstInvalidTx, tx, sizeof(spiFirstInvalidTx));
  memcpy(spiFirstInvalidRx, rx, sizeof(spiFirstInvalidRx));
  spiFirstInvalidTxSeq = ND_SPI::get32(tx + 4);
  spiFirstInvalidMagic = ND_SPI::get16(rx);
  spiFirstInvalidVersion = rx[2];
  spiFirstInvalidType = rx[3];
  spiFirstInvalidLength = ND_SPI::get16(rx + 8);
  spiFirstInvalidReady = digitalRead(ESP_SPI_READY) ? 1 : 0;
  strncpy(spiFirstInvalidReason, reason, sizeof(spiFirstInvalidReason) - 1);
  Serial.println(F("[SPI FIRST INVALID]"));
  Serial.print(F("txSeq=")); Serial.print(spiFirstInvalidTxSeq);
  Serial.print(F(" reason=")); Serial.println(spiFirstInvalidReason);
  Serial.print(F("TX16=")); for (size_t i = 0; i < sizeof(spiFirstInvalidTx); ++i) { if (i) Serial.print(' '); if (spiFirstInvalidTx[i] < 16) Serial.print('0'); Serial.print(spiFirstInvalidTx[i], HEX); } Serial.println();
  Serial.print(F("RX32=")); for (size_t i = 0; i < sizeof(spiFirstInvalidRx); ++i) { if (i) Serial.print(' '); if (spiFirstInvalidRx[i] < 16) Serial.print('0'); Serial.print(spiFirstInvalidRx[i], HEX); } Serial.println();
  Serial.print(F("magicObserved=0x")); Serial.println(spiFirstInvalidMagic, HEX);
  Serial.print(F("versionObserved=")); Serial.println(spiFirstInvalidVersion);
  Serial.print(F("typeObserved=")); Serial.println(spiFirstInvalidType);
  Serial.print(F("lengthObserved=")); Serial.println(spiFirstInvalidLength);
  Serial.print(F("ready=")); Serial.println(spiFirstInvalidReady);
}
#endif
static void serviceEspSpi() {
  const uint32_t now = millis(); if (spiSynced && now - espUartLastSeenMs > 1500u) { spiSynced = false; ++spiLinkResyncs; } if (now - spiLastPollMs < ESP_SPI_POLL_MS) return; spiLastPollMs = now;
  if (!spiSynced && now - lastEspUartHeartbeatMs >= 500u) { queueSpiHello(); lastEspUartHeartbeatMs = now; }
  if (!spiPop(spiTxFrame)) ND_SPI::build(spiTxFrame, ND_SPI::SPI_MSG_NOP, spiSequence, 0, 0, nullptr, 0);
  SPI1.beginTransaction(SPISettings(ND_SPI::CLOCK_HZ, MSBFIRST, SPI_MODE0)); digitalWrite(ESP_SPI_CS, LOW); SPI1.transfer(spiTxFrame, spiRxFrame, ND_SPI::FRAME_BYTES); digitalWrite(ESP_SPI_CS, HIGH); SPI1.endTransaction();
  ++spiTransactions; espUartTxBytes += ND_SPI::FRAME_BYTES; espUartRxBytes += ND_SPI::FRAME_BYTES;
#if ND_SPI_FORENSIC_DIAGNOSTICS
  captureFirstInvalidSpiFrame(spiTxFrame, spiRxFrame);
#endif
  processSpiFrame(spiRxFrame);
  if (now - spiLastStatusMs >= 5000u) { spiLastStatusMs = now; Serial.print(F("[SPI] synced=")); Serial.print(spiSynced ? 1 : 0); Serial.print(F(" tx=")); Serial.print(spiTransactions); Serial.print(F(" rx=")); Serial.print(spiTransactions); Serial.print(F(" valid=")); Serial.print(spiValidFrames); Serial.print(F(" crc=")); Serial.print(spiCrcErrors); Serial.print(F(" drops=")); Serial.print(spiRxDrops + spiTxDrops + spiLightingDrops); Serial.print(F(" resync=")); Serial.println(spiLinkResyncs); }
}
void initEspUart() { pinMode(ESP_SPI_CS, OUTPUT); digitalWrite(ESP_SPI_CS, HIGH); pinMode(ESP_SPI_READY, INPUT_PULLDOWN); SPI1.setRX(ESP_SPI_MISO); SPI1.setCS(ESP_SPI_CS); SPI1.setSCK(ESP_SPI_SCK); SPI1.setTX(ESP_SPI_MOSI); SPI1.begin(false); espUartReady = true; queueSpiHello(); queueSpiStatusSubscription(); Serial.println(F("[DIAG] ESP32 SPI: PASS (SPI1 GP12/13/14/15 READY GP11 / 1MHz mode 0)")); }
void serviceEspUart() { if (espUartReady) serviceEspSpi(); }

#endif

// W5500-EVB-Pico2 integrated Ethernet allocation.  These GPIOs are routed
// on the board and must not be reassigned to application peripherals.
#define W5500_MISO_PIN 16
#define W5500_CS_PIN   17
#define W5500_SCK_PIN  18
#define W5500_MOSI_PIN 19
#define W5500_RST_PIN  20
#define W5500_INT_PIN  21  // Reserved by the board; Ethernet is polled here.

// Manage the PIO program loading offset
static int pio0_offset = -1;
static int pio1_offset = -1;

// Core cross-conflict flags
volatile bool systemReady = false;
volatile uint32_t core1_heartbeat = 0; 
volatile uint32_t core1Stage = 0;
volatile int8_t core1StagePort = -1;
volatile uint32_t core1LastProgressMs = 0;
spin_lock_t* dmx_lock = nullptr;
// Short, non-blocking ownership flag for the shared DMX buffers.  Neither
// core is allowed to wait forever for the other core.
volatile uint32_t dmx_buffer_busy = 0;

static inline bool tryAcquireDmxBuffer() {
  uint32_t expected = 0;
  return __atomic_compare_exchange_n(&dmx_buffer_busy, &expected, 1u, false,
                                     __ATOMIC_ACQUIRE, __ATOMIC_RELAXED);
}

static inline void releaseDmxBuffer() {
  __atomic_store_n(&dmx_buffer_busy, 0u, __ATOMIC_RELEASE);
}

static inline void setCore1Checkpoint(uint32_t stage, int port = -1) {
  core1StagePort = static_cast<int8_t>(port);
  __atomic_store_n(&core1Stage, stage, __ATOMIC_RELAXED);
}

// ================= PIO DMX DRIVER =================
static const uint16_t dmx_program_instructions[] = {
    0x98a0, // pull block side 1
    0xf327, // set x, 7 side 0 [3]
    0x6201, // out pins, 1 [2]
    0x0042, // jmp x--, 2
    0xbe42  // nop side 1 [6]
};
static const struct pio_program dmx_program = { dmx_program_instructions, 5, -1 };

class PIODMX {
private:
    PIO pio; uint sm; uint offset; uint pin; pio_sm_config c;
public:
    bool begin(PIO pio_hw, uint sm_num, uint tx_pin) {
        pio = pio_hw; sm = sm_num; pin = tx_pin;
        
        if (pio == pio0) {
            if (pio0_offset == -1) pio0_offset = pio_add_program(pio, &dmx_program);
            offset = pio0_offset;
        } else {
            if (pio1_offset == -1) pio1_offset = pio_add_program(pio, &dmx_program);
            offset = pio1_offset;
        }

        c = pio_get_default_sm_config();
        sm_config_set_wrap(&c, offset + 0, offset + 4);
        sm_config_set_out_pins(&c, pin, 1);
        sm_config_set_sideset_pins(&c, pin);
        sm_config_set_sideset(&c, 2, true, false); 
        sm_config_set_out_shift(&c, true, false, 32);
        sm_config_set_fifo_join(&c, PIO_FIFO_JOIN_TX);
        sm_config_set_clkdiv(&c, (float)clock_get_hz(clk_sys) / (250000.0f * 4.0f));

        pio_sm_set_pins_with_mask(pio, sm, 1u << pin, 1u << pin);
        pio_sm_set_pindirs_with_mask(pio, sm, 1u << pin, 1u << pin);
        pio_gpio_init(pio, pin);

        pio_sm_init(pio, sm, offset, &c);
        pio_sm_set_enabled(pio, sm, true);
        return true;
    }
    
    inline bool put_byte(uint8_t b) {
        if (pio_sm_is_tx_fifo_full(pio, sm)) return false;
        pio_sm_put(pio, sm, b);
        return true;
    }

    uint getOffset() const { return offset; }

    // Hold the state machine during BREAK.  The PIO program itself remains
    // configured and is not restarted for every DMX frame.
    void stop() {
        pio_sm_set_enabled(pio, sm, false);
        gpio_set_function(pin, GPIO_FUNC_SIO);
        gpio_set_dir(pin, GPIO_OUT);
    }
    void resume() {
        pio_gpio_init(pio, pin);
        pio_sm_set_pindirs_with_mask(pio, sm, 1u << pin, 1u << pin);
        pio_sm_set_enabled(pio, sm, true);
    }
    
    void reset_sm() {
        pio_sm_set_enabled(pio, sm, false);
        pio_sm_restart(pio, sm);
        pio_sm_clear_fifos(pio, sm);
        pio_sm_exec(pio, sm, pio_encode_jmp(offset));
        pio_sm_clkdiv_restart(pio, 1u << sm);
        pio_gpio_init(pio, pin);
        pio_sm_set_consecutive_pindirs(pio, sm, pin, 1, true);
        pio_sm_set_enabled(pio, sm, true);
    }
};

PIODMX dmxOutputs[4];

// ================= HARDWARE ASSIGNMENT =================
#define PIN_MISO W5500_MISO_PIN
#define PIN_CS   W5500_CS_PIN
#define PIN_SCK  W5500_SCK_PIN
#define PIN_MOSI W5500_MOSI_PIN
#define PIN_RST  W5500_RST_PIN
// MAX485 DI pins.  MAX485 DE and /RE are not MCU-controlled in this design.
const uint8_t RS485_PINS[4] = {2, 3, 27, 28};
static bool dmxPioReady[4] = {false, false, false, false};

byte mac[] = { 0x02, 0x4E, 0x44, 0x34, 0x55, 0x01 };
// Arduino-Pico's core-native W5500 compatibility layer. The controller is
// physically integrated on this board; GP21 is reserved for its INTn even
// though the firmware uses link/socket polling rather than an IRQ path.
// Force Arduino-Pico lwIP transparent polling.  GP21 is reserved on the
// W5500-EVB-Pico2; passing it as intr selects interrupt mode and removes the
// library's background packet poller, which leaves ARP unserviced on this
// board configuration.  Keep the physical INT allocation reserved.
ArduinoWiznet5500lwIP Ethernet(W5500_CS_PIN, SPI, -1);
EthernetServer server(80);
EthernetUDP artnetUdp;
EthernetUDP sacnDdp;             
EthernetUDP sacnMulticastUdp[4]; 

// Native Ethernet lighting ingress diagnostics. These counters are
// observational only and are exposed through /api/status for bring-up.
static uint32_t ethernetArtRxCount = 0;
static uint32_t ethernetArtAcceptedCount = 0;
static uint32_t ethernetSacnRxCount = 0;
static uint32_t ethernetSacnAcceptedCount = 0;
static bool ethernetInitialized = false;
static uint16_t lastEthernetUniverse = 0;
static char lastEthernetProtocol[8] = "NONE";

#define ARTNET_PORT 6454
#define SACN_PORT   5568

#define DEVICE_MODEL       "ND DMX NODE 4U"
#define FIRMWARE_VERSION   "V3.6F5-RP2350"
#define HARDWARE_REVISION  "W5500-EVB-Pico2 / RP2350 + integrated W5500 + 4x DMX + ESP32-C5"
#define DASHBOARD_REFRESH_MS 1000
#define EVENT_LOG_SIZE 10
static constexpr uint32_t RP_SPI_HEALTH_TIMEOUT_MS = 1500;
static constexpr uint32_t RP_OTA_REJECT_DRAIN_TIMEOUT_MS = 1500;

enum RpOtaState : uint8_t {
  RP_OTA_IDLE,
  RP_OTA_RECEIVING,
  RP_OTA_VERIFYING,
  RP_OTA_READY_TO_REBOOT,
  RP_OTA_REBOOTING,
  RP_OTA_FAILED
};

static RpOtaState rpOtaState = RP_OTA_IDLE;
static bool rpOtaBusy = false;
static uint32_t rpOtaReceived = 0;
static uint32_t rpOtaTotal = 0;
static char rpOtaLastError[96] = "";
static size_t ethernetContentLength = 0;
static bool ethernetUpdateConfirm = false;
static char ethernetContentType[64] = "";

static const char *rpOtaStateName() {
  switch (rpOtaState) {
    case RP_OTA_RECEIVING: return "RECEIVING";
    case RP_OTA_VERIFYING: return "VERIFYING";
    case RP_OTA_READY_TO_REBOOT: return "READY_TO_REBOOT";
    case RP_OTA_REBOOTING: return "REBOOTING";
    case RP_OTA_FAILED: return "FAILED";
    default: return "IDLE";
  }
}

static size_t rpOtaMaximumImageSize() {
  return static_cast<size_t>(&_FS_end - &_FS_start);
}

static void rpOtaSetError(const char *message) {
  rpOtaState = RP_OTA_FAILED;
  strncpy(rpOtaLastError, message ? message : "OTA failed", sizeof(rpOtaLastError) - 1);
  rpOtaLastError[sizeof(rpOtaLastError) - 1] = '\0';
  rpOtaBusy = false;
}

enum OutputTestMode : uint8_t {
  TEST_NETWORK = 0,
  TEST_BLACKOUT = 1,
  TEST_HALF = 2,
  TEST_FULL = 3,
  TEST_CHASE = 4
};

struct EventLogEntry {
  uint32_t timestampMs;
  char message[58];
};

struct Config {
  uint16_t startUniverse; 
  uint8_t manualMode; 
  uint16_t portUniverses[4]; 
  uint8_t portEnabled[4];
  uint8_t portProtocol[4]; 
  uint8_t mergeMode;       
} cfg;

struct SystemDiagnostics {
  uint32_t core0Loops;
  uint32_t core1Loops;
  uint32_t maxNetTimeUs;
  uint32_t totalPacketsReceived;
} sysLog;

enum DmxTxState {
  STATE_IDLE = 0,
  STATE_BREAK,
  STATE_MAB,
  STATE_SENDING
};

struct PortStatus {
  uint16_t universe; bool active; uint32_t lastPacketMs;
  uint32_t frameCount; uint32_t lastFpsMs; float fps; uint16_t usedChannels;
  volatile uint32_t dmxFrameCount; uint32_t lastDmxFpsMs; float dmxFps;
  uint8_t currentPriority; IPAddress sender; char protocol[8];
  
  bool conflict;
  IPAddress conflictIP;
  uint32_t lastConflictMs;

  uint8_t dmxBuffer[513];       
  uint8_t activeDmxBuffer[513]; 
  volatile bool hasNewData; 
  uint32_t nextFrameTimeUs;     
  volatile bool engineRunning;
  volatile uint32_t lastDmxFrameMs;
  volatile uint32_t recoveryCount;
  
  DmxTxState state;
  uint32_t stateStartTimeUs;
  uint16_t txIndex;

  volatile uint8_t testMode;
  uint16_t chaseChannel;
  uint32_t lastChaseStepMs;
};

PortStatus ports[4]; 
EventLogEntry eventLog[EVENT_LOG_SIZE];
uint8_t eventLogHead = 0;
uint8_t eventLogCount = 0;
uint8_t packetBuffer[768]; 
auto lastLinkStatus = LinkON;

volatile uint32_t lCount0 = 0, lCount1 = 0, maxNetTime = 0;


uint8_t calcCRC(const Config& target) {
  uint8_t crc = lowByte(target.startUniverse) + highByte(target.startUniverse) + target.manualMode + target.mergeMode;
  for(int i=0; i<4; i++) {
    crc += lowByte(target.portUniverses[i]) + highByte(target.portUniverses[i]) + target.portEnabled[i] + target.portProtocol[i];
  }
  return crc;
}

void saveConfig() {
  EEPROM.write(0, 0x51); 
  EEPROM.write(1, lowByte(cfg.startUniverse)); EEPROM.write(2, highByte(cfg.startUniverse)); EEPROM.write(3, cfg.manualMode);
  for(int i=0; i<4; i++) {
    EEPROM.write(4+(i*2), lowByte(cfg.portUniverses[i])); EEPROM.write(5+(i*2), highByte(cfg.portUniverses[i]));
    EEPROM.write(12+i, cfg.portEnabled[i]);
    EEPROM.write(16+i, cfg.portProtocol[i]);
  }
  EEPROM.write(20, cfg.mergeMode);
  EEPROM.write(21, calcCRC(cfg)); EEPROM.commit();
}

void setupSacnSockets();
void sendWifiUniverseSubscriptions();

void loadConfig() {
  EEPROM.begin(64);
  Config temp;
  temp.startUniverse = EEPROM.read(1) | (EEPROM.read(2) << 8);
  temp.manualMode = EEPROM.read(3);
  for(int i=0; i<4; i++) {
    temp.portUniverses[i] = EEPROM.read(4+(i*2)) | (EEPROM.read(5+(i*2)) << 8);
    temp.portEnabled[i] = EEPROM.read(12+i);
    temp.portProtocol[i] = EEPROM.read(16+i);
  }
  temp.mergeMode = EEPROM.read(20);
  
  uint8_t crc = calcCRC(temp);
  
  if (EEPROM.read(0) == 0x51 && EEPROM.read(21) == crc) {
    cfg = temp;
  } else {
    cfg.startUniverse = 1; cfg.manualMode = 0; cfg.mergeMode = 0; 
    for(int i=0; i<4; i++) { 
      cfg.portUniverses[i] = i + 1; 
      cfg.portEnabled[i] = 1; 
      cfg.portProtocol[i] = 0; 
    }
    saveConfig();
  }
}

void updateUniverseMap() {
  for (int i = 0; i < 4; i++) {
    ports[i].universe = (cfg.manualMode == 1) ? cfg.portUniverses[i] : (cfg.startUniverse + i);
    ports[i].active = false; ports[i].fps = 0; ports[i].usedChannels = 0; strcpy(ports[i].protocol, "-");
    ports[i].conflict = false; ports[i].hasNewData = false; ports[i].lastFpsMs = millis(); ports[i].nextFrameTimeUs = 0;
    ports[i].dmxFrameCount = 0; ports[i].lastDmxFpsMs = millis(); ports[i].dmxFps = 0;
    ports[i].state = STATE_IDLE; ports[i].txIndex = 0;
    ports[i].engineRunning = cfg.portEnabled[i] != 0;
    __atomic_store_n(&ports[i].lastDmxFrameMs, millis(), __ATOMIC_RELAXED); ports[i].recoveryCount = 0;
    ports[i].testMode = TEST_NETWORK; ports[i].chaseChannel = 1; ports[i].lastChaseStepMs = 0;
    memset((void*)ports[i].dmxBuffer, 0, 513);
    memset((void*)ports[i].activeDmxBuffer, 0, 513);
  }
  setupSacnSockets(); 
  sendWifiUniverseSubscriptions();
}

void sendWifiUniverseSubscriptions() {
#if ND_ETH_BISECT_STAGE >= 5
  char subscriptions[64];
  snprintf(subscriptions, sizeof(subscriptions), "%u,%u,%u,%u",
           ports[0].universe, ports[1].universe, ports[2].universe, ports[3].universe);
  sendEspFrame("SUB", espUartNextId++, subscriptions);
#endif
}

void setupSacnSockets() {
  sacnDdp.stop();
  sacnDdp.begin(SACN_PORT); 
  
  for (int i = 0; i < 4; i++) {
    sacnMulticastUdp[i].stop();
    uint16_t u = ports[i].universe;
    if (cfg.portEnabled[i] && u > 0) {
      bool alreadyJoined = false;
      for (int j = 0; j < i; j++) {
        if (cfg.portEnabled[j] && ports[j].universe == u) {
          alreadyJoined = true;
          break;
        }
      }
      if (!alreadyJoined) {
        IPAddress mIP(239, 255, (u >> 8) & 0xFF, u & 0xFF);
        sacnMulticastUdp[i].beginMulticast(mIP, SACN_PORT);
      }
    }
  }
}

// ================= CORE 0: NETWORK & WEB SERVER =================
uint16_t getUsedChannels(uint8_t *data, uint16_t len) {
  for (int i = len - 1; i >= 0; i--) if (data[i] != 0) return i + 1;
  return 0;
}

void addEvent(const char* message) {
  EventLogEntry &entry = eventLog[eventLogHead];
  entry.timestampMs = millis();
  strncpy(entry.message, message, sizeof(entry.message) - 1);
  entry.message[sizeof(entry.message) - 1] = '\0';
  eventLogHead = (eventLogHead + 1) % EVENT_LOG_SIZE;
  if (eventLogCount < EVENT_LOG_SIZE) eventLogCount++;
}

void addPortEvent(int portIndex, const char* detail) {
  char message[58];
  snprintf(message, sizeof(message), "Port %d %s", portIndex + 1, detail);
  addEvent(message);
}

const char* testModeName(uint8_t mode) {
  switch (mode) {
    case TEST_BLACKOUT: return "BLACKOUT";
    case TEST_HALF: return "50 PERCENT";
    case TEST_FULL: return "FULL";
    case TEST_CHASE: return "CHASE";
    default: return "NETWORK";
  }
}

void printMac(DashboardWriter& c) {
  for (int i = 0; i < 6; i++) {
    if (i) c.print(':');
    if (mac[i] < 16) c.print('0');
    c.print(mac[i], HEX);
  }
}

void sendArtPollReply(IPAddress remoteIP) {
#if EMERGENCY_NETWORK_SAFE_MODE
  // Disabled: Art-Net discovery reply is non-essential UDP TX. RX remains enabled.
  (void)remoteIP;
  return;
#else
    uint8_t reply[240];
    memset(reply, 0, sizeof(reply));

    memcpy(reply, "Art-Net\0", 8);
    reply[8] = 0x00; reply[9] = 0x21;

    IPAddress ip = Ethernet.localIP();
    reply[10] = ip[0]; reply[11] = ip[1]; reply[12] = ip[2]; reply[13] = ip[3];

    reply[14] = 0x36; reply[15] = 0x19;
    reply[16] = 0x00; reply[17] = 0x01;

    uint16_t u = ports[0].universe - 1;
    reply[18] = (u >> 8) & 0x7F; reply[19] = (u >> 4) & 0x0F;

    reply[20] = 0xFF; reply[21] = 0xFF;
    reply[22] = 0x00; reply[23] = 0x08; reply[24] = 0x00; reply[25] = 0x00;

    strncpy((char*)&reply[26], "ND DMX System", 17);
    strncpy((char*)&reply[44], "ND DMX System 4-Port Node", 63);

    snprintf((char*)&reply[108], 63, "#0001 [0000] ND DMX System OK");

    reply[172] = 0x00; reply[173] = 0x04;
    for(int i = 0; i < 4; i++) reply[174 + i] = 0x80;

    memset(reply + 178, 0, 4);
    for(int i = 0; i < 4; i++) reply[182 + i] = ports[i].active ? 0x80 : 0x00;

    memset(reply + 186, 0, 4);
    for(int i = 0; i < 4; i++) reply[190 + i] = (ports[i].universe - 1) & 0x0F;

    memset(reply + 194, 0, 7);
    reply[201] = 0x00;

    memcpy(reply + 202, mac, 6);
    reply[208] = ip[0]; reply[209] = ip[1]; reply[210] = ip[2]; reply[211] = ip[3];
    reply[212] = 1; reply[213] = 0x08; 

    memset(reply + 214, 0, 26); 

    artnetUdp.beginPacket(remoteIP, ARTNET_PORT);
    artnetUdp.write(reply, 240);
  artnetUdp.endPacket();
#endif
}

void processDmxData(int i, uint8_t* d, uint16_t len, uint8_t prio, IPAddress ip, const char* name) {
  uint32_t now = millis();
  bool wasActive = ports[i].active;
  
  if (cfg.portProtocol[i] == 1 && strcmp(name, "Art-Net") != 0) return;
  if (cfg.portProtocol[i] == 2 && strcmp(name, "sACN") != 0) return;

  if (ports[i].active && (now - ports[i].lastPacketMs < 1000) && ip != ports[i].sender) {
    bool isNewConflict = !ports[i].conflict;
    ports[i].conflict = true;
    ports[i].conflictIP = ip;
    ports[i].lastConflictMs = now;
    if (isNewConflict) addPortEvent(i, "source conflict detected");
  }

  if (cfg.mergeMode == 2) {
    if (ports[i].active && (now - ports[i].lastPacketMs < 1000) && ip != ports[i].sender) return; 
  }

  if (ports[i].active && strcmp(ports[i].protocol, "sACN") == 0 && prio < ports[i].currentPriority && (now - ports[i].lastPacketMs < 1000)) return; 
  
  ports[i].active = true; ports[i].lastPacketMs = now; ports[i].currentPriority = prio;
  ports[i].sender = ip;
  
  strncpy(ports[i].protocol, name, sizeof(ports[i].protocol) - 1);
  ports[i].protocol[sizeof(ports[i].protocol) - 1] = '\0';
  
  if (len > 512) len = 512;
  ports[i].usedChannels = getUsedChannels(d, len);
  
  // A packet may be dropped if Core 1 is copying a frame.  It is safer to
  // drop one update than to block the network task indefinitely.
  if (!tryAcquireDmxBuffer()) return;
  
  if (cfg.mergeMode == 1 && ports[i].active) {
    for (uint16_t k = 0; k < len; k++) {
      if (d[k] > ports[i].dmxBuffer[1 + k]) {
        ports[i].dmxBuffer[1 + k] = d[k];
      }
    }
  } else { 
    memcpy(ports[i].dmxBuffer + 1, d, len);
    if (len < 512) memset(ports[i].dmxBuffer + 1 + len, 0, 512 - len);
  }
  
  ports[i].hasNewData = true; 
  releaseDmxBuffer();
  
  if (!wasActive) {
    char detail[46];
    snprintf(detail, sizeof(detail), "%s source active", name);
    addPortEvent(i, detail);
  }

  ports[i].frameCount++; sysLog.totalPacketsReceived++;
}

void parseSacnPacket(EthernetUDP& udp) {
  int sacnSize = udp.parsePacket();
  if (sacnSize > 0) ++ethernetSacnRxCount;
  if (sacnSize >= 126 && sacnSize <= (int)sizeof(packetBuffer)) {
    udp.read(packetBuffer, sacnSize);
    if (memcmp(packetBuffer + 4, "ASC-E1.17", 9) == 0) {
      if (packetBuffer[21] == 0x04 && packetBuffer[43] == 0x02) {
        const uint16_t u = (static_cast<uint16_t>(packetBuffer[113]) << 8) | packetBuffer[114];
        const uint16_t rawLen = (static_cast<uint16_t>(packetBuffer[123]) << 8) | packetBuffer[124];
        if (rawLen < 1u || rawLen > 513u || static_cast<uint32_t>(126u + (rawLen - 1u)) > static_cast<uint32_t>(sacnSize) || packetBuffer[125] != 0u) {
          return;
        }

        const uint16_t len = rawLen - 1u;
        const uint8_t prio = packetBuffer[108];

        for (int i = 0; i < 4; i++) {
          if (u == ports[i].universe && cfg.portEnabled[i]) {
            ++ethernetSacnAcceptedCount;
            lastEthernetUniverse = u;
            strcpy(lastEthernetProtocol, "sACN");
            processDmxData(i, packetBuffer + 126, len, prio, udp.remoteIP(), "sACN");
            break;
          }
        }
      }
    }
  }
}

void handleNetworkPackets() {
  int artSize = artnetUdp.parsePacket();
  if (artSize > 0) ++ethernetArtRxCount;
  if (artSize >= 10 && artSize <= (int)sizeof(packetBuffer)) {
    artnetUdp.read(packetBuffer, artSize);
    if (memcmp(packetBuffer, "Art-Net", 8) == 0) {
      uint16_t opcode = packetBuffer[8] | (packetBuffer[9] << 8);
      if (opcode == 0x5000) { 
        if (artSize >= 18) {
          uint16_t len = (packetBuffer[16] << 8) | packetBuffer[17];
          if (18 + len <= artSize) {
            uint16_t u = packetBuffer[14] | (packetBuffer[15] << 8);
            for (int i = 0; i < 4; i++) {
              if (u == ports[i].universe && cfg.portEnabled[i]) {
                ++ethernetArtAcceptedCount;
                lastEthernetUniverse = u;
                strcpy(lastEthernetProtocol, "Art-Net");
                processDmxData(i, packetBuffer + 18, len, 100, artnetUdp.remoteIP(), "Art-Net");
                break;
              }
            }
          }
        }
      } else if (opcode == 0x2000) {
        sendArtPollReply(artnetUdp.remoteIP());
      }
    }
  }
  parseSacnPacket(sacnDdp);
  for (int i = 0; i < 4; i++) parseSacnPacket(sacnMulticastUdp[i]); 
}

int getParamValue(const char* req, const char* key) {
  char searchKey[16]; snprintf(searchKey, sizeof(searchKey), "%s=", key);
  char* pos = strstr((char*)req, searchKey); if (!pos) return -1;
  return atoi(pos + strlen(searchKey));
}

void printIP(DashboardWriter& c, IPAddress ip) {
  c.print(ip[0]); c.print('.'); c.print(ip[1]); c.print('.'); c.print(ip[2]); c.print('.'); c.print(ip[3]);
}

static const uint8_t INDEX_HTML_GZ[] = {
  0x1F, 0x8B, 0x08, 0x00, 0x00, 0x00, 0x00, 0x00, 0x02, 0xFF, 0xD5, 0x7D, 0xDB, 0x72, 0xDB, 0x48,
  0xB2, 0xE0, 0xBB, 0xBF, 0x02, 0xA6, 0xA7, 0x0D, 0xE2, 0x18, 0xA4, 0x08, 0x90, 0xD4, 0x85, 0x14,
  0xA5, 0x23, 0x4B, 0xF2, 0x58, 0xD3, 0xB2, 0xA4, 0x90, 0xE4, 0xEE, 0xE9, 0xE8, 0xE8, 0xE8, 0x00,
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  0x32, 0x9D, 0x6C, 0xBD, 0xF8, 0xFF, 0xC1, 0xBA, 0x11, 0x46, 0x7A, 0xB7, 0x00, 0x00,
};

static uint8_t ethernetResponseBuffer[16384];
static uint8_t interprocessorResponseBuffer[ESP_UART_RESPONSE_MAX];
static bool interprocessorResponseBusy = false;

class EthernetDashboardWriter : public DashboardWriter {
  EthernetClient& client;
  uint8_t* buffer;
  const size_t capacity;
  size_t length = 0;
  bool overflowed = false;
public:
  explicit EthernetDashboardWriter(EthernetClient& c, uint8_t* responseBuffer)
      : client(c), buffer(responseBuffer), capacity(16384u) {}
  bool connected() const override { return client.connected() && !overflowed; }
  size_t write(uint8_t b) override { return write(&b, 1); }
  size_t write(const uint8_t* data, size_t len) override {
    if (len > capacity - length) { overflowed = true; return 0; }
    memcpy(buffer + length, data, len);
    length += len;
    return len;
  }
  bool flushResponse() {
    size_t sent = 0;
    uint32_t lastProgressMs = millis();
    while (sent < length && client.connected()) {
      const size_t remaining = length - sent;
      const size_t block = remaining > 512 ? 512 : remaining;
      const size_t written = client.write(buffer + sent, block);
      if (written > 0) {
        sent += written;
        lastProgressMs = millis();
        handleNetworkPackets();
        watchdog_update();
      } else {
        if (millis() - lastProgressMs >= 1500u) break;
        handleNetworkPackets();
        watchdog_update();
        delay(1);
      }
    }
    return !overflowed && sent == length;
  }
  void service() override { handleNetworkPackets(); watchdog_update(); }
};

class UartDashboardWriter : public DashboardWriter {
  uint8_t* buffer; const size_t capacity; size_t length = 0; bool overflowed = false;
public:
  explicit UartDashboardWriter(uint8_t* responseBuffer) : buffer(responseBuffer), capacity(ESP_UART_RESPONSE_MAX) {}
  bool connected() const override { return !overflowed; }
  size_t write(uint8_t b) override { return write(&b, 1); }
  size_t write(const uint8_t* data, size_t len) override {
    if (len > capacity - length) { overflowed = true; return 0; }
    memcpy(buffer + length, data, len); length += len; return len;
  }
  const uint8_t* data() const { return buffer; }
  size_t size() const { return length; }
};

#if ND_INTERPROCESS_SPI
static bool spiQueueFrame(uint8_t type, uint32_t sequence, uint16_t flags, uint32_t channel, const uint8_t *payload, uint16_t length, bool lighting);
void dispatchDashboardRequest(DashboardWriter& client, const char* requestLine);
static void queueSpiApiResponse(uint16_t requestId, const UartDashboardWriter& response) {
  ++espHttpResponsesStarted; lastResponseId = requestId; lastResponseBytes = response.size();
  const size_t chunk = ND_SPI::MAX_PAYLOAD;
  if (!response.size()) { const uint8_t empty = 0; spiQueueFrame(ND_SPI::SPI_MSG_API_RESPONSE, spiSequence, ND_SPI::FLAG_FIRST | ND_SPI::FLAG_LAST, requestId, &empty, 0); }
  for (size_t off = 0; off < response.size(); off += chunk) {
    const size_t n = (response.size() - off > chunk) ? chunk : response.size() - off;
    uint16_t flags = (off == 0 ? ND_SPI::FLAG_FIRST : 0) | (off + n < response.size() ? ND_SPI::FLAG_MORE : ND_SPI::FLAG_LAST);
    if (!spiQueueFrame(ND_SPI::SPI_MSG_API_RESPONSE, spiSequence, flags, requestId, response.data() + off, uint16_t(n))) break;
    ++espHttpDataChunksSent;
  }
  ++espHttpResponsesCompleted;
}

static void processSpiFrame(const uint8_t *frame) {
  ++espUartRxLines;
  uint8_t error = 0;
  if (!ND_SPI::validate(frame, &error)) { ++espUartInvalidFrames; if (error == 1) ++spiMagicErrors; else if (error == 2) ++spiVersionErrors; else if (error == 3) ++spiLengthErrors; else ++spiCrcErrors; ++spiRxDrops; return; }
  ++spiValidFrames; ++espUartValidFrames; ++espValidFrameCount; espUartLinkAlive = true; espUartLastSeenMs = millis();
  const uint8_t type = frame[3]; const uint16_t length = ND_SPI::get16(frame + 8); const uint32_t channel = ND_SPI::get32(frame + 12); const uint8_t *payload = frame + ND_SPI::HEADER_BYTES;
  if (type == ND_SPI::SPI_MSG_HELLO || type == ND_SPI::SPI_MSG_HELLO_ACK) {
    spiSynced = true; ++espUartReadyFrames; strncpy(espLastFrameType, "HELLO", sizeof(espLastFrameType) - 1); return;
  }
  if (type == ND_SPI::SPI_MSG_STATUS_REQUEST) return;
  if (type == ND_SPI::SPI_MSG_API_REQUEST) {
    if (length == 0 || length >= ESP_UART_REQUEST_MAX) { ++spiRxDrops; return; }
    if (interprocessorResponseBusy) { ++spiRxDrops; return; }
    interprocessorResponseBusy = true;
    ++espUartReqFrames; ++espHttpReqReceived; lastReqId = uint16_t(channel); UartDashboardWriter response(interprocessorResponseBuffer); char request[ESP_UART_REQUEST_MAX]; memcpy(request, payload, length); request[length] = '\0'; dispatchDashboardRequest(response, request); queueSpiApiResponse(uint16_t(channel), response); interprocessorResponseBusy = false; return;
  }
  if (type == ND_SPI::SPI_MSG_ARTNET_UNIVERSE || type == ND_SPI::SPI_MSG_SACN_UNIVERSE) {
    if (length < 5 || length - 5 > 512) { ++spiRxDrops; ++spiLightingDrops; return; }
    const uint16_t universe = uint16_t(channel); const uint8_t priority = payload[0]; IPAddress source(payload[1], payload[2], payload[3], payload[4]);
    const char *name = type == ND_SPI::SPI_MSG_ARTNET_UNIVERSE ? "Art-Net" : "sACN";
    for (int i = 0; i < 4; ++i) if (ports[i].universe == universe && cfg.portEnabled[i]) { processDmxData(i, const_cast<uint8_t*>(payload + 5), uint16_t(length - 5), priority, source, name); if (type == ND_SPI::SPI_MSG_ARTNET_UNIVERSE) ++espWifiArtRxCount; else ++espWifiSacnRxCount; return; }
    ++spiRxDrops; ++spiLightingDrops; return;
  }
  if (type == ND_SPI::SPI_MSG_STATUS_RESPONSE) {
    if (length >= 5 && !memcmp(payload, "ACK|", 4)) { unsigned long id = strtoul(reinterpret_cast<const char*>(payload + 4), nullptr, 10); if (espWifiConfigPending && uint16_t(id) == espWifiConfigPendingId) { espWifiConfigAcked = true; espWifiConfigPending = false; strncpy(espWifiConfigAckMessage, "wifi-applied", sizeof(espWifiConfigAckMessage) - 1); } return; }
    const size_t n = length < sizeof(espWifiStatus) - 1 ? length : sizeof(espWifiStatus) - 1; memcpy(espWifiStatus, payload, n); espWifiStatus[n] = '\0'; ++espTelemetryFrameCount; ++espTelemetryDecodeSuccessCount; strncpy(espLastFrameType, "STATUS", sizeof(espLastFrameType) - 1); return;
  }
}
#endif

bool writeAll(DashboardWriter& client, const uint8_t* data, size_t length) {
  const size_t CHUNK_SIZE = 512;
  size_t sent = 0;
  uint32_t lastProgressMs = millis();

  while (sent < length && client.connected()) {
    const size_t remaining = length - sent;
    const size_t block = remaining > CHUNK_SIZE ? CHUNK_SIZE : remaining;
    const size_t written = client.write(data + sent, block);

    if (written > 0) {
      sent += written;
      lastProgressMs = millis();
      client.service();
    } else {
      if (millis() - lastProgressMs > 1500) break;
      delay(1);
    }
  }
  return sent == length;
}

bool writeAll(DashboardWriter& client, const char* data, size_t length) {
  return writeAll(client, reinterpret_cast<const uint8_t*>(data), length);
}

void sendStaticHeader(DashboardWriter& client, const char* status, const char* contentType, size_t contentLength, const char* cacheControl) {
  char header[320];
  const int count = snprintf(
    header, sizeof(header),
    "HTTP/1.1 %s\r\nContent-Type: %s\r\nContent-Length: %lu\r\nCache-Control: %s\r\nX-Content-Type-Options: nosniff\r\nConnection: close\r\n\r\n",
    status, contentType, static_cast<unsigned long>(contentLength), cacheControl
  );
  if (count > 0) writeAll(client, header, static_cast<size_t>(count));
}

void sendDynamicJsonHeader(DashboardWriter& client, bool ok = true) {
  client.println(ok ? F("HTTP/1.1 200 OK") : F("HTTP/1.1 400 Bad Request"));
  client.println(F("Content-Type: application/json; charset=utf-8"));
  client.println(F("Cache-Control: no-store, no-cache, must-revalidate"));
  client.println(F("X-Content-Type-Options: nosniff"));
  client.println(F("Connection: close"));
  client.println();
}

void printJsonString(DashboardWriter& client, const char* value) {
  client.print('"');
  if (value) {
    for (const char* p = value; *p; ++p) {
      const char ch = *p;
      if (ch == '"' || ch == '\\') { client.print('\\'); client.print(ch); } 
      else if (ch == '\n') { client.print(F("\\n")); } 
      else if (static_cast<uint8_t>(ch) >= 0x20) { client.print(ch); }
    }
  }
  client.print('"');
}

void printMacString(DashboardWriter& client) {
  client.print('"');
  for (int i = 0; i < 6; ++i) {
    if (i) client.print(':');
    if (mac[i] < 16) client.print('0');
    client.print(mac[i], HEX);
  }
  client.print('"');
}

uint64_t getSystemUptimeSeconds() { return time_us_64() / 1000000ULL; }

static const char* rpSpiHealthName(uint32_t now) {
  if (!espUartReady) return "FAILED";
  if (!spiSynced || espUartLastSeenMs == 0 || now - espUartLastSeenMs > RP_SPI_HEALTH_TIMEOUT_MS) return "DEGRADED";
  return "HEALTHY";
}

static uint32_t rpSpiLastValidAge(uint32_t now) {
  return espUartLastSeenMs == 0 ? 0xFFFFFFFFu : now - espUartLastSeenMs;
}

void printUInt64(DashboardWriter& client, uint64_t value) {
  char buffer[24]; snprintf(buffer, sizeof(buffer), "%llu", static_cast<unsigned long long>(value)); client.print(buffer);
}

void sendStatusJson(DashboardWriter& client) {
  sendDynamicJsonHeader(client, true);
  const uint32_t now = millis();

  client.print(F("{\"model\":")); printJsonString(client, DEVICE_MODEL);
  client.print(F(",\"firmware\":")); printJsonString(client, FIRMWARE_VERSION);
  client.print(F(",\"hardware\":")); printJsonString(client, HARDWARE_REVISION);
  client.print(F(",\"build\":"));
  client.print('"'); client.print(__DATE__); client.print(' '); client.print(__TIME__); client.print('"');
  client.print(F(",\"mac\":")); printMacString(client);
  client.print(F(",\"ip\":"));
  client.print('"'); printIP(client, Ethernet.localIP()); client.print('"');
  client.print(F(",\"ethernetInitialized\":")); client.print(ethernetInitialized ? F("true") : F("false"));
  client.print(F(",\"link\":")); client.print(Ethernet.linkStatus() == LinkON ? F("true") : F("false"));
  client.print(F(",\"wifi\":{\"link\":")); client.print(espUartLinkAlive ? F("true") : F("false"));
  client.print(F(",\"status\":")); printJsonString(client, espWifiStatus);
  client.print(F(",\"lastFrame\":")); printJsonString(client, espLastFrameType);
  client.print(F(",\"validFrames\":")); client.print(espValidFrameCount);
  client.print(F(",\"telemetryFrames\":")); client.print(espTelemetryFrameCount);
  client.print(F(",\"telemetryDecodeSuccess\":")); client.print(espTelemetryDecodeSuccessCount);
  client.print(F(",\"telemetryDecodeFailure\":")); client.print(espTelemetryDecodeFailureCount);
  client.print(F(",\"telemetryValidationFailure\":")); client.print(espTelemetryValidationFailureCount);
  client.print(F(",\"lastTelemetryLength\":")); client.print(espLastTelemetryLength);
  client.print(F(",\"lastTelemetryResult\":")); printJsonString(client, espLastTelemetryResult);
  client.print(F(",\"rxOverflow\":")); client.print(espUartRxOverflowCount);
  client.print(F(",\"uartDiag\":{"));
  client.print(F("\"rxBytes\":")); client.print(espUartRxBytes);
  client.print(F(",\"rxLines\":")); client.print(espUartRxLines);
  client.print(F(",\"valid\":")); client.print(espUartValidFrames);
  client.print(F(",\"invalid\":")); client.print(espUartInvalidFrames);
  client.print(F(",\"unknown\":")); client.print(espUartUnknownFrames);
  client.print(F(",\"req\":")); client.print(espUartReqFrames);
  client.print(F(",\"ready\":")); client.print(espUartReadyFrames);
  client.print(F(",\"hb\":")); client.print(espUartHbFrames);
  client.print(F(",\"wifi\":")); client.print(espUartWifiFrames);
  client.print(F(",\"txBytes\":")); client.print(espUartTxBytes);
  client.print(F(",\"txFrames\":")); client.print(espUartTxFrames);
  client.print(F(",\"resp\":")); client.print(espUartRespFrames);
  client.print(F(",\"data\":")); client.print(espUartDataFrames);
  client.print(F(",\"end\":")); client.print(espUartEndFrames);
  client.print(F(",\"httpReq\":")); client.print(espHttpReqReceived);
  client.print(F(",\"httpStarted\":")); client.print(espHttpResponsesStarted);
  client.print(F(",\"httpChunks\":")); client.print(espHttpDataChunksSent);
  client.print(F(",\"httpCompleted\":")); client.print(espHttpResponsesCompleted);
  client.print(F(",\"lastReqId\":")); client.print(lastReqId);
  client.print(F(",\"lastReqPath\":")); printJsonString(client, lastReqPath);
  client.print(F(",\"lastResponseId\":")); client.print(lastResponseId);
  client.print(F(",\"lastResponseStatus\":")); printJsonString(client, lastResponseStatus);
  client.print(F(",\"lastResponseBytes\":")); client.print(lastResponseBytes);
  client.print(F(",\"lastInvalidLength\":")); client.print(lastInvalidFrameLength);
  client.print(F(",\"lastInvalidReason\":")); printJsonString(client, lastInvalidFrameReason);
  client.print(F(",\"lastInvalidPrefix\":")); printJsonString(client, lastInvalidFrame);
  client.print('}');
  client.print(F(",\"spi\":{\"state\":")); printJsonString(client, spiSynced ? "CONNECTED" : (espUartReady ? "SYNCING" : "DISCONNECTED"));
  client.print(F(",\"health\":")); printJsonString(client, rpSpiHealthName(now));
  client.print(F(",\"initialized\":")); client.print(espUartReady ? F("true") : F("false"));
  client.print(F(",\"clockHz\":")); client.print(ND_SPI::CLOCK_HZ);
  client.print(F(",\"transactions\":")); client.print(spiTransactions);
  client.print(F(",\"validFrames\":")); client.print(spiValidFrames);
  client.print(F(",\"crcErrors\":")); client.print(spiCrcErrors);
  client.print(F(",\"protocolInvalid\":")); client.print(spiMagicErrors + spiVersionErrors + spiLengthErrors + spiSequenceErrors);
  client.print(F(",\"rxDrops\":")); client.print(spiRxDrops);
  client.print(F(",\"txQueueDrops\":")); client.print(spiTxDrops);
  client.print(F(",\"lightingDrops\":")); client.print(spiLightingDrops);
  client.print(F(",\"drops\":")); client.print(spiRxDrops + spiTxDrops + spiLightingDrops);
  client.print(F(",\"resyncs\":")); client.print(spiLinkResyncs);
  client.print(F(",\"lastValidAgeMs\":")); const uint32_t spiAge = rpSpiLastValidAge(now); if (spiAge == 0xFFFFFFFFu) client.print(F("null")); else client.print(spiAge);
  client.print(F(",\"readyHigh\":")); client.print(spiReadyHighCount);
  client.print(F(",\"readyMismatch\":")); client.print(spiReadyMismatchCount);
  client.print('}');
  client.print(F(",\"wifiArtRx\":")); client.print(espWifiArtRxCount);
  client.print(F(",\"wifiArtDrops\":")); client.print(espWifiArtDropCount);
  client.print(F(",\"wifiSacnRx\":")); client.print(espWifiSacnRxCount);
  client.print(F(",\"wifiSacnDrops\":")); client.print(espWifiSacnDropCount);
  client.print(F(",\"ethernetArtRx\":")); client.print(ethernetArtRxCount);
  client.print(F(",\"ethernetArtAccepted\":")); client.print(ethernetArtAcceptedCount);
  client.print(F(",\"ethernetSacnRx\":")); client.print(ethernetSacnRxCount);
  client.print(F(",\"ethernetSacnAccepted\":")); client.print(ethernetSacnAcceptedCount);
  client.print(F(",\"lastEthernetUniverse\":")); client.print(lastEthernetUniverse);
  client.print(F(",\"lastEthernetProtocol\":")); printJsonString(client, lastEthernetProtocol);
  client.print('}');
  client.print(F(",\"mode\":")); client.print(cfg.manualMode);
  client.print(F(",\"start\":")); client.print(cfg.startUniverse);
  client.print(F(",\"merge\":")); client.print(cfg.mergeMode);
  client.print(F(",\"uptime\":")); printUInt64(client, getSystemUptimeSeconds());
  client.print(F(",\"previousResetCode\":")); client.print(previousResetCode);
  client.print(F(",\"previousResetReason\":")); printJsonString(client, resetReason(previousResetCode));
  client.print(F(",\"previousBootStage\":")); printJsonString(client, bootStageName(previousBootStage));
  client.print(F(",\"previousBootCompleted\":")); client.print(previousBootCompleted ? F("true") : F("false"));
  client.print(F(",\"lastRuntimeStage\":")); printJsonString(client, runtimeStageName(watchdog_hw->scratch[4]));
  client.print(F(",\"c0\":")); client.print(sysLog.core0Loops);
  client.print(F(",\"c1\":")); client.print(sysLog.core1Loops);
  client.print(F(",\"core1Heartbeat\":")); client.print(__atomic_load_n(&core1_heartbeat, __ATOMIC_RELAXED));
  client.print(F(",\"core1Stage\":")); client.print(__atomic_load_n(&core1Stage, __ATOMIC_RELAXED));
  client.print(F(",\"core1StagePort\":")); client.print(static_cast<int>(core1StagePort));
  const uint32_t core1ProgressMs = __atomic_load_n(&core1LastProgressMs, __ATOMIC_RELAXED);
  client.print(F(",\"core1LastProgressMs\":")); client.print(core1ProgressMs);
  client.print(F(",\"core1ProgressAgeMs\":"));
  if (!core1ProgressMs) client.print(F("null"));
  else if (now < core1ProgressMs) client.print(0u);
  else client.print(now - core1ProgressMs);
  client.print(F(",\"net\":")); client.print(sysLog.maxNetTimeUs);
  client.print(F(",\"packets\":")); client.print(sysLog.totalPacketsReceived);
  uint8_t dmxActiveOutputs = 0; bool dmxInitialized = true;
  for (int i = 0; i < 4; ++i) { if (cfg.portEnabled[i]) ++dmxActiveOutputs; if (!dmxPioReady[i]) dmxInitialized = false; }
  client.print(F(",\"dmx\":{\"initialized\":")); client.print(dmxInitialized ? F("true") : F("false"));
  client.print(F(",\"activeOutputs\":")); client.print(dmxActiveOutputs); client.print('}');
  client.print(F(",\"ports\":["));

  for (int i = 0; i < 4; ++i) {
    if (i) client.print(',');
    client.print(F("{\"port\":")); client.print(i + 1);
    client.print(F(",\"en\":")); client.print(cfg.portEnabled[i] ? 1 : 0);
    client.print(F(",\"pmode\":")); client.print(cfg.portProtocol[i]);
    client.print(F(",\"universe\":")); client.print(ports[i].universe);
    client.print(F(",\"active\":")); client.print(ports[i].active ? F("true") : F("false"));
    client.print(F(",\"engine\":")); client.print(ports[i].engineRunning ? F("true") : F("false"));
    const uint32_t lastDmxFrameMs = __atomic_load_n(&ports[i].lastDmxFrameMs, __ATOMIC_RELAXED);
    client.print(F(",\"lastDmx\":")); client.print(now < lastDmxFrameMs ? 0u : now - lastDmxFrameMs);
    client.print(F(",\"recoveries\":")); client.print(ports[i].recoveryCount);
    client.print(F(",\"conflict\":")); client.print(ports[i].conflict ? F("true") : F("false"));
    client.print(F(",\"fps\":")); client.print(ports[i].fps, 1);
    client.print(F(",\"dmxFps\":")); client.print(ports[i].dmxFps, 1);
    client.print(F(",\"used\":")); client.print(ports[i].usedChannels);
    client.print(F(",\"age\":")); client.print(ports[i].active ? now - ports[i].lastPacketMs : 0);
    client.print(F(",\"prio\":")); client.print(ports[i].currentPriority);
    client.print(F(",\"test\":")); client.print(ports[i].testMode);
    client.print(F(",\"proto\":")); printJsonString(client, ports[i].protocol);
    client.print(F(",\"sender\":")); client.print('"'); printIP(client, ports[i].sender); client.print('"');
    client.print(F(",\"c_ip\":")); client.print('"'); printIP(client, ports[i].conflictIP); client.print('"');
    client.print('}');
  }

  client.print(F("],\"events\":["));
  for (uint8_t n = 0; n < eventLogCount; ++n) {
    if (n) client.print(',');
    const int index = (eventLogHead + EVENT_LOG_SIZE - 1 - n) % EVENT_LOG_SIZE;
    client.print(F("{\"t\":")); client.print(eventLog[index].timestampMs);
    client.print(F(",\"m\":")); printJsonString(client, eventLog[index].message);
    client.print('}');
  }
  client.print(F("]}"));
}

void sendJsonResult(DashboardWriter& client, bool ok, const char* message = nullptr) {
  sendDynamicJsonHeader(client, ok);
  client.print(F("{\"ok\":")); client.print(ok ? F("true") : F("false"));
  if (message) {
    client.print(ok ? F(",\"message\":") : F(",\"error\":"));
    printJsonString(client, message);
  }
  client.print('}');
}

void sendTestResponse(DashboardWriter& client, const char* requestLine) {
  const int port = getParamValue(requestLine, "p");
  const int mode = getParamValue(requestLine, "m");

  if (port < 0 || port >= 4 || mode < TEST_NETWORK || mode > TEST_CHASE) {
    sendJsonResult(client, false, "Invalid port or test mode"); return;
  }
  if (mode != TEST_NETWORK && !cfg.portEnabled[port]) {
    sendJsonResult(client, false, "Enable the port before starting a test"); return;
  }

  if (!tryAcquireDmxBuffer()) {
    sendJsonResult(client, false, "DMX engine busy; try again");
    return;
  }
  ports[port].testMode = static_cast<uint8_t>(mode);
  ports[port].chaseChannel = 1;
  ports[port].lastChaseStepMs = 0;
  releaseDmxBuffer();

  char detail[50];
  snprintf(detail, sizeof(detail), "test mode %s", testModeName(static_cast<uint8_t>(mode)));
  addPortEvent(port, detail);
  sendJsonResult(client, true, "Test mode updated");
}

bool applyConfigFromRequest(const char* requestLine, char* error, size_t errorSize) {
  const int mode = getParamValue(requestLine, "mode");
  const int start = getParamValue(requestLine, "start");
  const int merge = getParamValue(requestLine, "merge");

  if (mode < 0 || mode > 1) { snprintf(error, errorSize, "Routing mode must be 0 or 1"); return false; }
  if (start < 1 || start > 63996) { snprintf(error, errorSize, "Start universe must be 1 to 63996"); return false; }
  if (merge < 0 || merge > 2) { snprintf(error, errorSize, "Merge mode must be 0 to 2"); return false; }

  Config next = cfg;
  next.manualMode = static_cast<uint8_t>(mode);
  next.startUniverse = static_cast<uint16_t>(start);
  next.mergeMode = static_cast<uint8_t>(merge);

  for (int i = 0; i < 4; ++i) {
    char key[4];
    snprintf(key, sizeof(key), "u%d", i); const int universe = getParamValue(requestLine, key);
    snprintf(key, sizeof(key), "e%d", i); const int enabled = getParamValue(requestLine, key);
    snprintf(key, sizeof(key), "p%d", i); const int protocol = getParamValue(requestLine, key);

    if (universe < 1 || universe > 63999 || enabled < 0 || enabled > 1 || protocol < 0 || protocol > 2) {
      snprintf(error, errorSize, "Invalid configuration for Port %d", i + 1); return false;
    }
    next.portUniverses[i] = static_cast<uint16_t>(universe);
    next.portEnabled[i] = static_cast<uint8_t>(enabled);
    next.portProtocol[i] = static_cast<uint8_t>(protocol);
  }

  cfg = next;
  saveConfig();
  updateUniverseMap();
  addEvent("Configuration saved");
  return true;
}

void sendConfigResponse(DashboardWriter& client, const char* requestLine) {
  char error[72] = {0};
  const bool ok = applyConfigFromRequest(requestLine, error, sizeof(error));
  sendJsonResult(client, ok, ok ? "Configuration saved" : error);
}

void sendWifiStatusResponse(DashboardWriter& client) {
  sendDynamicJsonHeader(client, true);
  client.print(F("{\"ok\":true,\"link\":")); client.print(espUartLinkAlive ? F("true") : F("false"));
  client.print(F(",\"status\":")); printJsonString(client, espWifiStatus); client.print('}');
}

void sendWifiConfigResponse(DashboardWriter& client, const char* requestLine) {
#if ND_INTERPROCESS_UART
  char encoded[720];
  const size_t n = b64Encode(reinterpret_cast<const uint8_t*>(requestLine), strlen(requestLine), encoded, sizeof(encoded));
  if (!n || !espUartReady || !espUartLinkAlive) { sendJsonResult(client, false, "ESP32 Wi-Fi link is not ready"); return; }
  const uint16_t id = espUartNextId++;
  espWifiConfigPending = true; espWifiConfigAcked = false; espWifiConfigPendingId = id; espWifiConfigAckMessage[0] = '\0';
  sendEspFrame("WIFI_SET", id, encoded);
  const uint32_t started = millis();
  while (espWifiConfigPending && millis() - started < 1500u) { serviceEspUart(); delay(1); }
  if (espWifiConfigPending) { espWifiConfigPending = false; sendJsonResult(client, false, "ESP32 Wi-Fi apply timed out"); return; }
  sendJsonResult(client, espWifiConfigAcked, espWifiConfigAcked ? "Wi-Fi apply acknowledged" : "ESP32 Wi-Fi apply failed");
#else
  if (!espUartReady || !espUartLinkAlive || strlen(requestLine) >= ND_SPI::MAX_PAYLOAD) { sendJsonResult(client, false, "ESP32 Wi-Fi link is not ready"); return; }
  const uint16_t id = espUartNextId++; espWifiConfigPending = true; espWifiConfigAcked = false; espWifiConfigPendingId = id; espWifiConfigAckMessage[0] = '\0';
  sendEspFrame("WIFI_SET", id, requestLine); const uint32_t started = millis(); while (espWifiConfigPending && millis() - started < 1500u) { serviceEspUart(); delay(1); }
  if (espWifiConfigPending) { espWifiConfigPending = false; sendJsonResult(client, false, "ESP32 Wi-Fi apply timed out"); return; }
  sendJsonResult(client, espWifiConfigAcked, espWifiConfigAcked ? "Wi-Fi apply acknowledged" : "ESP32 Wi-Fi apply failed");
#endif
}

void sendRpOtaStatus(DashboardWriter& client, bool ok = true) {
  sendDynamicJsonHeader(client, ok);
  client.print(F("{\"ok\":")); client.print(ok ? F("true") : F("false"));
  client.print(F(",\"target\":\"RP2350\",\"installed\":\"")); client.print(FIRMWARE_VERSION);
  client.print(F("\",\"state\":\"")); client.print(rpOtaStateName());
  client.print(F("\",\"transport\":\"Ethernet\",\"receivedBytes\":")); client.print(rpOtaReceived);
  client.print(F(",\"totalBytes\":")); client.print(rpOtaTotal);
  const unsigned percent = rpOtaTotal ? static_cast<unsigned>((uint64_t(rpOtaReceived) * 100u) / rpOtaTotal) : 0u;
  client.print(F(",\"percent\":")); client.print(percent);
  client.print(F(",\"maximumImageSize\":")); client.print(rpOtaMaximumImageSize());
  client.print(F(",\"lastError\":")); printJsonString(client, rpOtaLastError);
  client.print('}');
}

static void sendRpOtaError(DashboardWriter& client, const char *message) {
  rpOtaSetError(message);
  sendRpOtaStatus(client, false);
}

static void discardRpOtaRequestBody(EthernetClient& client) {
  if (!ethernetContentLength) return;
  uint8_t scratch[256];
  size_t remaining = ethernetContentLength;
  const uint32_t started = millis();
  while (remaining && client.connected() && millis() - started < RP_OTA_REJECT_DRAIN_TIMEOUT_MS) {
    const int available = client.available();
    if (available <= 0) {
      watchdog_update();
      delay(1);
      continue;
    }
    size_t want = remaining < sizeof(scratch) ? remaining : sizeof(scratch);
    if (want > static_cast<size_t>(available)) want = static_cast<size_t>(available);
    const int n = client.read(scratch, want);
    if (n > 0) remaining -= static_cast<size_t>(n);
    watchdog_update();
  }
}

static void sendRpOtaValidationError(EthernetClient& client, EthernetDashboardWriter& writer, const char *message) {
  discardRpOtaRequestBody(client);
  sendRpOtaError(writer, message);
  writer.flushResponse();
}

static bool readRpOtaBody(EthernetClient& client) {
  uint8_t buffer[1024];
  uint32_t lastData = millis();
  while (rpOtaReceived < rpOtaTotal) {
    const int available = client.available();
    if (available <= 0) {
      if (millis() - lastData > 15000u) return false;
      watchdog_update();
      delay(1);
      continue;
    }
    size_t want = rpOtaTotal - rpOtaReceived;
    if (want > sizeof(buffer)) want = sizeof(buffer);
    if (want > static_cast<size_t>(available)) want = static_cast<size_t>(available);
    const int n = client.read(buffer, want);
    if (n <= 0) continue;
    const size_t written = Update.write(buffer, static_cast<size_t>(n));
    if (written != static_cast<size_t>(n)) return false;
    rpOtaReceived += static_cast<uint32_t>(written);
    lastData = millis();
    watchdog_update();
  }
  return true;
}

static void handleRpOtaUpload(EthernetClient& client, const char *requestLine) {
  EthernetDashboardWriter writer(client, ethernetResponseBuffer);
  if (rpOtaBusy) { sendRpOtaValidationError(client, writer, "update already in progress"); return; }
  if (strcmp(requestLine, "POST /api/ota/rp HTTP/1.1") != 0 && strcmp(requestLine, "POST /api/ota/rp HTTP/1.0") != 0) {
    sendRpOtaValidationError(client, writer, "invalid RP OTA request"); return;
  }
  if (!ethernetUpdateConfirm) { sendRpOtaValidationError(client, writer, "explicit update confirmation required"); return; }
  if (strcmp(ethernetContentType, "application/octet-stream") != 0) {
    sendRpOtaValidationError(client, writer, "Content-Type must be application/octet-stream"); return;
  }
  if (!ethernetContentLength || ethernetContentLength > rpOtaMaximumImageSize()) {
    sendRpOtaValidationError(client, writer, "image exceeds RP OTA staging capacity"); return;
  }

  rpOtaBusy = true;
  rpOtaState = RP_OTA_RECEIVING;
  rpOtaReceived = 0;
  rpOtaTotal = static_cast<uint32_t>(ethernetContentLength);
  rpOtaLastError[0] = '\0';
  if (!Update.begin(ethernetContentLength, U_FLASH)) {
    char error[96]; snprintf(error, sizeof(error), "Updater begin failed (%u)", Update.getError());
    sendRpOtaValidationError(client, writer, error); return;
  }
  if (!readRpOtaBody(client)) {
    char error[96]; snprintf(error, sizeof(error), "receive/write failed (%u)", Update.getError());
    sendRpOtaError(writer, error); writer.flushResponse(); return;
  }
  rpOtaState = RP_OTA_VERIFYING;
  if (!Update.end()) {
    char error[96]; snprintf(error, sizeof(error), "Updater finalization failed (%u)", Update.getError());
    sendRpOtaError(writer, error); writer.flushResponse(); return;
  }
  rpOtaState = RP_OTA_READY_TO_REBOOT;
  rpOtaBusy = false;
  sendRpOtaStatus(writer, true);
  writer.flushResponse();
  delay(250);
  rpOtaState = RP_OTA_REBOOTING;
  rp2040.reboot();
}

static bool isRpOtaUploadRequest(const char *requestLine) {
  if (!requestLine || strncmp(requestLine, "POST ", 5) != 0) return false;
  const char *target = requestLine + 5;
  const char *version = strchr(target, ' ');
  if (!version || version == target) return false;
  const size_t targetLength = static_cast<size_t>(version - target);
  return targetLength >= 11 && strncmp(target, "/api/ota/rp", 11) == 0 &&
         (targetLength == 11 || target[11] == '?');
}

void sendDashboardPage(DashboardWriter& client) {
  const size_t pageLength = sizeof(INDEX_HTML_GZ);
  char header[384];
  const int count = snprintf(
      header, sizeof(header),
      "HTTP/1.1 200 OK\r\nContent-Type: text/html; charset=utf-8\r\nContent-Encoding: gzip\r\nContent-Length: %lu\r\nCache-Control: no-store, no-cache, must-revalidate\r\nVary: Accept-Encoding\r\nX-Content-Type-Options: nosniff\r\nConnection: close\r\n\r\n",
      static_cast<unsigned long>(pageLength));

  if (count > 0) {
    writeAll(client, header, static_cast<size_t>(count));
    writeAll(client, INDEX_HTML_GZ, sizeof(INDEX_HTML_GZ));
  }
}

void dispatchDashboardRequest(DashboardWriter& client, const char* requestLine) {
  if (strncmp(requestLine, "GET /api/status", 15) == 0) sendStatusJson(client);
  else if (strncmp(requestLine, "GET /api/ota/rp/status", 22) == 0) sendRpOtaStatus(client);
  else if (strncmp(requestLine, "GET /api/wifi/status", 20) == 0) sendWifiStatusResponse(client);
  else if (strncmp(requestLine, "GET /api/wifi/config?", 21) == 0) sendWifiConfigResponse(client, requestLine);
  else if (strncmp(requestLine, "GET /api/test?", 14) == 0) sendTestResponse(client, requestLine);
  else if (strncmp(requestLine, "GET /api/config?", 16) == 0) sendConfigResponse(client, requestLine);
  else if (strncmp(requestLine, "GET /set?", 9) == 0) {
    char error[72] = {0};
    const bool ok = applyConfigFromRequest(requestLine, error, sizeof(error));
    if (ok) { client.println(F("HTTP/1.1 303 See Other")); client.println(F("Location: /")); client.println(F("Connection: close")); client.println(); }
    else sendJsonResult(client, false, error);
  } else if (strncmp(requestLine, "GET /favicon.ico", 16) == 0) {
    client.println(F("HTTP/1.1 204 No Content")); client.println(F("Connection: close")); client.println();
  } else if (strncmp(requestLine, "GET / ", 6) == 0 || strncmp(requestLine, "GET /index.html", 15) == 0) sendDashboardPage(client);
  else {
    static const char NOT_FOUND[] = "Not found";
    sendStaticHeader(client, "404 Not Found", "text/plain; charset=utf-8", sizeof(NOT_FOUND) - 1, "no-store");
    writeAll(client, NOT_FOUND, sizeof(NOT_FOUND) - 1);
  }
}

#if ND_INTERPROCESS_UART
void sendEspHttpResponse(uint16_t id, UartDashboardWriter& response) {
  ++espHttpResponsesStarted;
  lastResponseId = id;
  lastResponseBytes = response.size();
  copyHttpStatus(response.data(), response.size());
  char header[48]; snprintf(header, sizeof(header), "%lu", static_cast<unsigned long>(response.size()));
  sendEspFrame("RESP", id, header);
  char encoded[ESP_UART_CHUNK * 4 / 3 + 8];
  for (size_t offset = 0; offset < response.size(); offset += ESP_UART_CHUNK) {
    const size_t block = (response.size() - offset > ESP_UART_CHUNK) ? ESP_UART_CHUNK : response.size() - offset;
    if (!b64Encode(response.data() + offset, block, encoded, sizeof(encoded))) break;
    sendEspFrame("DATA", id, encoded);
    ++espHttpDataChunksSent;
  }
  sendEspFrame("END", id);
  ++espHttpResponsesCompleted;
}

void handleEspFrame(const char* line) {
  char type[16] = {0}; if (!uartField(line, 1, type, sizeof(type))) { strcpy(espLastTelemetryResult, "TYPE_FIELD_ERROR"); recordInvalidEspFrame(line, "MISSING_TYPE"); return; }
  char idText[12] = {0}; if (!uartField(line, 2, idText, sizeof(idText))) { recordInvalidEspFrame(line, "MISSING_ID"); return; }
  const uint16_t id = static_cast<uint16_t>(strtoul(idText, nullptr, 10));
  char payload[ESP_UART_LINE_MAX] = {0}; uartField(line, 3, payload, sizeof(payload));
  if (!strcmp(type, "READY") || !strcmp(type, "HB") || !strcmp(type, "WIFI")) {
    ++espUartValidFrames;
    if (!strcmp(type, "READY")) ++espUartReadyFrames;
    else if (!strcmp(type, "HB")) ++espUartHbFrames;
    else ++espUartWifiFrames;
  } else if (!strcmp(type, "ACK")) {
    ++espUartValidFrames;
  } else if (!strcmp(type, "WART") || !strcmp(type, "WSAC") || !strcmp(type, "REQ")) {
  } else {
    ++espUartUnknownFrames;
    recordInvalidEspFrame(line, "UNKNOWN_TYPE");
    return;
  }
  if (strcmp(type, "ACK") == 0 && espWifiConfigPending && id == espWifiConfigPendingId) {
    espWifiConfigAcked = true;
    strncpy(espWifiConfigAckMessage, payload, sizeof(espWifiConfigAckMessage) - 1);
    espWifiConfigAckMessage[sizeof(espWifiConfigAckMessage) - 1] = '\0';
    espWifiConfigPending = false;
    return;
  }
  if (strcmp(type, "WART") == 0 || strcmp(type, "WSAC") == 0) {
    uint8_t forwarded[sizeof(packetBuffer)];
    const size_t n = b64Decode(payload, forwarded, sizeof(forwarded));
    if (n < 9) { recordInvalidEspFrame(line, "BAD_BASE64"); return; }
    const uint16_t universe = (static_cast<uint16_t>(forwarded[0]) << 8) | forwarded[1];
    const uint8_t priority = forwarded[2];
    const uint16_t length = (static_cast<uint16_t>(forwarded[3]) << 8) | forwarded[4];
    if (length > 512 || n < static_cast<size_t>(9u + length)) { recordInvalidEspFrame(line, "BAD_BASE64"); return; }
    IPAddress source(forwarded[5], forwarded[6], forwarded[7], forwarded[8]);
    ++espUartValidFrames;
    for (int i = 0; i < 4; ++i) {
      if (universe == ports[i].universe && cfg.portEnabled[i]) {
        processDmxData(i, forwarded + 9, length, priority, source,
                       strcmp(type, "WART") == 0 ? "Art-Net" : "sACN");
        if (strcmp(type, "WART") == 0) ++espWifiArtRxCount; else ++espWifiSacnRxCount;
        return;
      }
    }
    return;
  }
  if (strcmp(type, "READY") == 0 || strcmp(type, "HB") == 0 || strcmp(type, "WIFI") == 0) {
    strncpy(espLastFrameType, type, sizeof(espLastFrameType) - 1);
    espLastFrameType[sizeof(espLastFrameType) - 1] = '\0';
    ++espValidFrameCount;
    espUartLinkAlive = true; espUartLastSeenMs = millis();
    ++espTelemetryFrameCount;
    if (payload[0] == '\0') {
      strcpy(espLastTelemetryResult, "NO_PAYLOAD");
      ++espTelemetryDecodeFailureCount;
    } else {
      uint8_t decoded[sizeof(espWifiStatus)];
      const size_t n = b64Decode(payload, decoded, sizeof(decoded) - 1);
      espLastTelemetryLength = static_cast<uint16_t>(n);
      if (!n) {
        strcpy(espLastTelemetryResult, "BASE64_ERROR");
        ++espTelemetryDecodeFailureCount;
      } else {
        decoded[n] = '\0';
        const char* telemetry = reinterpret_cast<const char*>(decoded);
        const bool valid = strstr(telemetry, "state=") && strstr(telemetry, "mode=") &&
                           strstr(telemetry, "ssid=") && strstr(telemetry, "ip=") &&
                           strstr(telemetry, "rssi=") && strstr(telemetry, "clients=") &&
                           !strstr(telemetry, "password=") && !strstr(telemetry, "pass=");
        if (!valid) {
          strcpy(espLastTelemetryResult, "TELEMETRY_FIELDS_ERROR");
          ++espTelemetryValidationFailureCount;
        } else {
          memcpy(espWifiStatus, decoded, n + 1);
          strcpy(espLastTelemetryResult, "OK");
          ++espTelemetryDecodeSuccessCount;
        }
      }
    }
  } else if (strcmp(type, "REQ") == 0) {
    uint8_t request[ESP_UART_REQUEST_MAX]; const size_t n = b64Decode(payload, request, sizeof(request) - 1);
    if (!n) { recordInvalidEspFrame(line, "BAD_BASE64"); return; }
    if (interprocessorResponseBusy) { ++espUartInvalidFrames; return; }
    interprocessorResponseBusy = true;
    request[n] = '\0'; ++espUartValidFrames; ++espUartReqFrames; ++espHttpReqReceived; lastReqId = id; copyReqPath(request, n);
    UartDashboardWriter response(interprocessorResponseBuffer); dispatchDashboardRequest(response, reinterpret_cast<const char*>(request)); sendEspHttpResponse(id, response); interprocessorResponseBusy = false;
  }
}
#endif


bool readRequestLine(EthernetClient& client, char* output, size_t capacity) {
  if (!output || capacity < 2) return false;
  size_t index = 0;
  size_t headerLineLength = 0;
  bool requestLineComplete = false;
  ethernetContentLength = 0;
  ethernetUpdateConfirm = false;
  ethernetContentType[0] = '\0';
  const uint32_t started = millis();
  char header[160] = {0};
  size_t headerIndex = 0;

  while (client.connected() && millis() - started < 300) {
    while (client.available()) {
      const char ch = static_cast<char>(client.read());
      if (!requestLineComplete) {
        if (ch == '\n') {
          output[index] = '\0';
          requestLineComplete = true;
          headerLineLength = 0;
        } else if (ch != '\r' && index < capacity - 1) {
          output[index++] = ch;
        }
      } else if (ch != '\r') {
        if (ch == '\n') {
          if (headerLineLength == 0) return index > 0;
          header[headerIndex] = '\0';
          if (strncasecmp(header, "Content-Length:", 15) == 0) {
            ethernetContentLength = static_cast<size_t>(strtoul(header + 15, nullptr, 10));
          } else if (strncasecmp(header, "Content-Type:", 13) == 0) {
            const char *value = header + 13; while (*value == ' ' || *value == '\t') ++value;
            strncpy(ethernetContentType, value, sizeof(ethernetContentType) - 1);
            ethernetContentType[sizeof(ethernetContentType) - 1] = '\0';
          } else if (strncasecmp(header, "X-ND-Update-Confirm:", 20) == 0) {
            const char *value = header + 20; while (*value == ' ' || *value == '\t') ++value;
            ethernetUpdateConfirm = strcasecmp(value, "yes") == 0;
          }
          headerLineLength = 0;
          headerIndex = 0;
        } else {
          ++headerLineLength;
          if (headerIndex < sizeof(header) - 1) header[headerIndex++] = ch;
        }
      }
    }
    watchdog_update();
    delay(1);
  }
  output[index] = '\0';
  return index > 0;
}

__attribute__((noinline)) void handleDashboardWriterRequest(EthernetClient& client, const char* requestLine) {
  EthernetDashboardWriter writer(client, ethernetResponseBuffer);
  dispatchDashboardRequest(writer, requestLine);
  writer.flushResponse();
  client.stop();
}

void handleWeb() {
  EthernetClient client = server.available();
  if (!client) return;

  char requestLine[512] = {0};
  if (!readRequestLine(client, requestLine, sizeof(requestLine))) { client.stop(); return; }

  if (isRpOtaUploadRequest(requestLine)) {
    handleRpOtaUpload(client, requestLine);
    client.stop();
    return;
  }

  handleDashboardWriterRequest(client, requestLine);
}

void setup() {
  Serial.begin(115200);
  delay(1000);
  const bool priorWatchdog = watchdog_caused_reboot();
  const uint32_t savedStage = watchdog_hw->scratch[1];
  if (priorWatchdog && watchdog_hw->scratch[0] == RESET_DIAG_MAGIC) {
    previousResetCode = savedStage & 0xFFu;
    previousBootStage = (savedStage >> 8) & 0xFFu;
    previousBootCompleted = (savedStage & (1u << 16)) != 0;
    if (previousResetCode == 0) previousResetCode = 2;
  } else { previousResetCode = 0; previousBootStage = BOOT_START; previousBootCompleted = true; }
  Serial.println(F("ND_DMX_NODE v2.2"));
  Serial.println(F("W5500-EVB-Pico2 / RP2350 + integrated W5500 + 4x DMX + ESP32-C5"));
  Serial.println(F("NETWORK SAFE MODE: ON"));
  Serial.println(F("[DIAG] RP2350 startup: PASS"));
  watchdog_enable(8388, 1);
  recordBootStage(BOOT_START);
  Serial.print(F("[BOOT] Previous reset: ")); Serial.println(resetReason(previousResetCode));
  Serial.print(F("[BOOT] Previous boot stage: ")); Serial.println(bootStageName(previousBootStage));
  Serial.print(F("[BOOT] Previous boot completed: ")); Serial.println(previousBootCompleted ? F("YES") : F("NO"));
  
  Serial.println(F("[BOOT] ND DMX NODE 4U v2.2"));
  pinMode(HARDWARE_LED_PIN, OUTPUT); digitalWrite(HARDWARE_LED_PIN, LOW);

#if ND_ETH_BISECT_STAGE >= 5
  initEspUart();
#else
  Serial.println(F("[BISECT] ESP32 UART: DISABLED"));
#endif

  recordBootStage(CONFIG_LOAD);
  loadConfig();
  
  recordBootStage(DMX_INIT);
#if ND_ETH_BISECT_STAGE >= 6
  for (int i = 0; i < 4; i++) {
    dmxPioReady[i] = dmxOutputs[i].begin(i < 2 ? pio0 : pio1, i % 2, RS485_PINS[i]);
    Serial.print(F("[DIAG] DMX/PIO port ")); Serial.print(i + 1);
    Serial.print(F(": ")); Serial.println(dmxPioReady[i] ? F("PASS") : F("FAIL"));
  }
  int lock_num = spin_lock_claim_unused(true);
  dmx_lock = spin_lock_init(lock_num);
#else
  Serial.println(F("[BISECT] DMX/Core 1: DISABLED"));
#endif

  // Reset the W5500 already integrated on the W5500-EVB-Pico2 board.
  recordBootStage(W5500_RESET);
  pinMode(PIN_RST, OUTPUT); digitalWrite(PIN_RST, LOW); delay(100); digitalWrite(PIN_RST, HIGH); delay(500);

  recordBootStage(SPI_INIT);
  SPI.setRX(PIN_MISO); SPI.setCS(PIN_CS); SPI.setSCK(PIN_SCK); SPI.setTX(PIN_MOSI);
  SPI.begin();
  Serial.println(F("[DIAG] Integrated W5500 SPI: PASS (board pins configured)"));

  IPAddress staticIP(10, 10, 10, 10);
  IPAddress dnsServer(10, 10, 10, 1);
  IPAddress gateway(10, 10, 10, 1);
  IPAddress subnetMask(255, 255, 255, 0);
  recordBootStage(ETHERNET_INIT);
  const bool ethernetStarted = Ethernet.begin(mac, staticIP, dnsServer, gateway, subnetMask);
  ethernetInitialized = ethernetStarted && Ethernet.hardwareStatus() != EthernetNoHardware && Ethernet.localIP() == staticIP;
  recordBootStage(ETHERNET_READY);
  Serial.print(F("[DIAG] Integrated W5500 initialization: "));
  Serial.println(ethernetStarted && Ethernet.hardwareStatus() != EthernetNoHardware ? F("PASS") : F("FAIL"));
  Serial.print(F("[DIAG] IP configuration: "));
  Serial.println(Ethernet.localIP() == staticIP ? F("PASS (10.10.10.10)") : F("FAIL"));
  Serial.print(F("[DIAG] Effective network: IP=")); Serial.print(Ethernet.localIP());
  Serial.print(F(" MASK=")); Serial.print(Ethernet.subnetMask());
  Serial.print(F(" GW=")); Serial.print(Ethernet.gatewayIP()); Serial.print(F(" MAC="));
  for (uint8_t i = 0; i < 6; ++i) { if (i) Serial.print(':'); if (mac[i] < 16) Serial.print('0'); Serial.print(mac[i], HEX); }
  Serial.println();

  lastLinkStatus = Ethernet.linkStatus();
  Serial.print(F("[DIAG] Ethernet link: "));
  Serial.println(lastLinkStatus == LinkON ? F("PASS (up)") : F("FAIL (down)"));
  recordBootStage(SACN_INIT);
#if ND_ETH_BISECT_STAGE >= 4
  updateUniverseMap();
  Serial.println(F("[DIAG] sACN: PASS (UDP sockets initialized)"));
#else
  Serial.println(F("[BISECT] sACN: DISABLED"));
#endif
  recordBootStage(WEB_SERVER_INIT);
#if ND_ETH_BISECT_STAGE >= 2
  server.begin();
  Serial.println(F("[DIAG] HTTP server: PASS (port 80)"));
#else
  Serial.println(F("[BISECT] HTTP server: DISABLED"));
#endif
  recordBootStage(ARTNET_INIT);
#if ND_ETH_BISECT_STAGE >= 3
  artnetUdp.begin(ARTNET_PORT);
  Serial.println(F("[DIAG] Art-Net: PASS (UDP 6454)"));
#else
  Serial.println(F("[BISECT] Art-Net: DISABLED"));
#endif

  addEvent("System boot complete");
  if (priorWatchdog) {
    char resetEvent[58];
    snprintf(resetEvent, sizeof(resetEvent), "Previous reset: %s", resetReason(previousResetCode));
    addEvent(resetEvent);
  }
  recordBootStage(CORE_SYNC);
  asm volatile("dmb" : : : "memory");
  __atomic_store_n(&systemReady, true, __ATOMIC_RELEASE);
  asm volatile("sev");
  markBootComplete();

}

void loop() {
  watchdog_update();
  setRuntimeStage(RT_LOOP_START);
  
  static uint32_t lastWDCheck = 0;
  static uint32_t lastHeartbeat = 0;
  static uint8_t missedHeartbeats = 0;
  static bool core1StallReported = false;

  if (millis() - lastWDCheck >= 1000) {
    const uint32_t currentHeartbeat = __atomic_load_n(&core1_heartbeat, __ATOMIC_RELAXED);
    if (currentHeartbeat == lastHeartbeat) {
      if (++missedHeartbeats >= 3) {
        // Do not deliberately reboot the whole RP2350/W5500 stack merely
        // because Core 1 stopped reporting.  A reboot resets GP20/W5500 and
        // causes Ethernet link renegotiation.  The hardware watchdog remains
        // active and still handles a genuinely stalled Core 0.
        if (!core1StallReported) {
          Serial.println(F("[WARN] Core 1 heartbeat stalled; keeping Ethernet online"));
          core1StallReported = true;
        }
      }
    } else {
      lastHeartbeat = currentHeartbeat; missedHeartbeats = 0; core1StallReported = false;
    }
    lastWDCheck = millis();
  }
  
  static uint32_t lastLinkCheck = 0;
#if ND_ETH_BISECT_STAGE >= 7
  if (millis() - lastLinkCheck >= 1000) {
    auto currentLink = Ethernet.linkStatus();
    if (lastLinkStatus == LinkOFF && currentLink == LinkON) {
      artnetUdp.stop(); setupSacnSockets(); artnetUdp.begin(ARTNET_PORT); addEvent("Ethernet link restored");
    } else if (lastLinkStatus == LinkON && currentLink == LinkOFF) { addEvent("Ethernet link lost"); }
    lastLinkStatus = currentLink; lastLinkCheck = millis();
  }
#endif

  uint32_t t_start = micros();
  setRuntimeStage(RT_NETWORK_RX);
#if ND_ETH_BISECT_STAGE >= 3
  handleNetworkPackets();
#endif
#if ND_ETH_BISECT_STAGE >= 5
  serviceEspUart();
#endif
  setRuntimeStage(RT_ARTNET);
  setRuntimeStage(RT_SACN);
  uint32_t t_duration = micros() - t_start;
  if (t_duration > maxNetTime) maxNetTime = t_duration;

  uint32_t now = millis();
  for (int i = 0; i < 4; i++) {
    // Network source inactivity is not DMX engine inactivity.  Keep the
    // source state for diagnostics, but never use it to stop transmission.
    // The activeDmxBuffer remains the last valid universe/fallback frame.
    if (ports[i].conflict && (now - ports[i].lastConflictMs > 2000)) ports[i].conflict = false;
    if (now - ports[i].lastFpsMs >= 1000) {
      ports[i].fps = (ports[i].frameCount * 1000.0f) / (now - ports[i].lastFpsMs);
      ports[i].frameCount = 0; ports[i].lastFpsMs = now;
    }
    if (now - ports[i].lastDmxFpsMs >= 1000) {
      uint32_t outputFrames = __atomic_exchange_n(&ports[i].dmxFrameCount, 0u, __ATOMIC_RELAXED);
      ports[i].dmxFps = (outputFrames * 1000.0f) / (now - ports[i].lastDmxFpsMs); ports[i].lastDmxFpsMs = now;
    }
  }
  
  setRuntimeStage(RT_WEB);
#if ND_ETH_BISECT_STAGE >= 2
  handleWeb();
#endif
  setRuntimeStage(RT_DMX);

  setRuntimeStage(RT_LOOP_COMPLETE);

  lCount0++;
  static uint32_t lastReportMs = 0;
  if (millis() - lastReportMs >= 1000) {
    sysLog.core0Loops = lCount0; sysLog.core1Loops = __atomic_exchange_n(&lCount1, 0u, __ATOMIC_RELAXED); sysLog.maxNetTimeUs = maxNetTime;
    lCount0 = 0; maxNetTime = 0; lastReportMs = millis();
  }

  static uint32_t lastLED = 0;
  if (millis() - lastLED > 300) { digitalWrite(HARDWARE_LED_PIN, !digitalRead(HARDWARE_LED_PIN)); lastLED = millis(); }
}

// ================= CORE 1: INDEPENDENT DMX SIGNAL OUTPUT =================
void setup1() {}

void handleDmxTransmit(int i) {
  setCore1Checkpoint(3, i);
  const uint32_t nowMs = millis();
  const uint32_t nowUs = micros();
  const uint pin = RS485_PINS[i];

  switch (ports[i].state) {
    case STATE_IDLE: {
      const int32_t timeRemaining = static_cast<int32_t>(ports[i].nextFrameTimeUs - nowUs);
      if (timeRemaining <= 0) {
        setCore1Checkpoint(4, i);
        const bool bufferLocked = tryAcquireDmxBuffer();
        const uint8_t testMode = ports[i].testMode;
        if (bufferLocked && testMode == TEST_BLACKOUT) memset(ports[i].activeDmxBuffer, 0, 513);
        else if (bufferLocked && testMode == TEST_HALF) { ports[i].activeDmxBuffer[0] = 0; memset(ports[i].activeDmxBuffer + 1, 128, 512); } 
        else if (bufferLocked && testMode == TEST_FULL) { ports[i].activeDmxBuffer[0] = 0; memset(ports[i].activeDmxBuffer + 1, 255, 512); } 
        else if (bufferLocked && testMode == TEST_CHASE) {
          if (nowMs - ports[i].lastChaseStepMs >= 100) {
            ports[i].chaseChannel++; if (ports[i].chaseChannel > 512) ports[i].chaseChannel = 1; ports[i].lastChaseStepMs = nowMs;
          }
          memset(ports[i].activeDmxBuffer, 0, 513); ports[i].activeDmxBuffer[ports[i].chaseChannel] = 255;
        } else if (bufferLocked && ports[i].hasNewData) {
          memcpy(ports[i].activeDmxBuffer, ports[i].dmxBuffer, 513); ports[i].hasNewData = false;
        }
        if (bufferLocked) releaseDmxBuffer();
        setCore1Checkpoint(5, i);

        ports[i].nextFrameTimeUs = nowUs + 25000u;
        setCore1Checkpoint(6, i);
        dmxOutputs[i].stop();
        pinMode(pin, OUTPUT); digitalWrite(pin, LOW);
        ports[i].state = STATE_BREAK; ports[i].stateStartTimeUs = nowUs;
        ports[i].engineRunning = true;
        __atomic_fetch_add(&ports[i].dmxFrameCount, 1u, __ATOMIC_RELAXED);
      }
      break;
    }
    case STATE_BREAK:
      if (static_cast<uint32_t>(nowUs - ports[i].stateStartTimeUs) >= 105u) {
        digitalWrite(pin, HIGH); ports[i].state = STATE_MAB; ports[i].stateStartTimeUs = nowUs;
      }
      break;
    case STATE_MAB:
      if (static_cast<uint32_t>(nowUs - ports[i].stateStartTimeUs) >= 14u) {
        digitalWrite(pin, HIGH);
        dmxOutputs[i].resume();
        ports[i].state = STATE_SENDING; ports[i].stateStartTimeUs = nowUs; ports[i].txIndex = 0;
      }
      break;
    case STATE_SENDING: {
      setCore1Checkpoint(6, i);
      uint8_t fed = 0;
      while (ports[i].txIndex < 513 && fed < 16) {
        if (!dmxOutputs[i].put_byte(ports[i].activeDmxBuffer[ports[i].txIndex])) break;
        ports[i].txIndex++; fed++;
      }
      if (ports[i].txIndex >= 513) {
        ports[i].state = STATE_IDLE;
        __atomic_store_n(&ports[i].lastDmxFrameMs, nowMs, __ATOMIC_RELAXED);
      }
      else if (static_cast<uint32_t>(nowUs - ports[i].stateStartTimeUs) > 35000u) {
        dmxOutputs[i].reset_sm(); ports[i].txIndex = 0; ports[i].state = STATE_IDLE; ports[i].nextFrameTimeUs = nowUs + 1000u;
        ports[i].recoveryCount++;
      }
      setCore1Checkpoint(7, i);
      break;
    }
    default:
      dmxOutputs[i].reset_sm(); ports[i].txIndex = 0; ports[i].state = STATE_IDLE; ports[i].nextFrameTimeUs = nowUs + 1000u;
      ports[i].recoveryCount++;
      break;
  }
  setCore1Checkpoint(8, i);
}

void loop1() {
#if ND_ETH_BISECT_STAGE < 6
  while (true) { watchdog_update(); delay(100); }
#else
  if (!__atomic_load_n(&systemReady, __ATOMIC_ACQUIRE)) {
    while (!__atomic_load_n(&systemReady, __ATOMIC_ACQUIRE)) asm volatile("wfe");
    asm volatile("dmb" : : : "memory");
  }
  setCore1Checkpoint(1, -1);
  __atomic_store_n(&core1LastProgressMs, millis(), __ATOMIC_RELAXED);
  __atomic_fetch_add(&lCount1, 1u, __ATOMIC_RELAXED);
  __atomic_fetch_add(&core1_heartbeat, 1u, __ATOMIC_RELAXED);
  
  for (int i = 0; i < 4; i++) {
    setCore1Checkpoint(2, i);
    if (cfg.portEnabled[i] == 1) handleDmxTransmit(i);
  }
#endif
}

#endif  // ND_ETH_BISECT_STAGE == 1
